static const ui_profile_t ui_profile_800x480 __attribute__((unused)) = {
    .common = {
        .top_margin = 7,
        .sidebar_x = 5,
        .sidebar_w = 165,
        .content_x = 175,
        .content_y = 7,
        .content_w = 620,
        .content_h = 468,
        .title_line_x = 0,
        .title_line_w = 590,
        .title_line_y = 37,
    },


    .menu = {
        .tab_w = 165,
        .tab_h = 150,
        .tab_gap = 7,
        .tab_processes_y = 7,
        .tab_settings_y = 166,
        .tab_tools_y = 325,
        .tab_icon_offset_x = 0,
        .tab_icon_offset_y = -10,
        .tab_label_offset_x = 0,
        .tab_label_offset_y = 35,
        .tab_icon_font = &FilMachineFontIcons_60,
        .tab_label_font = &lv_font_montserrat_24,
        .wifi_icon_x = 15,
        .wifi_icon_y = -8,
        .wifi_icon_font = &lv_font_montserrat_28,
    },

    .processes = {
        .add_btn_w = 50,
        .add_btn_h = 50,
        .add_btn_x = -20,
        .add_btn_y = -12,
        .title_label_x = -7,
        .title_label_y = -5,
        .add_icon_x = 5,
        .add_icon_y = 0,
        .filter_btn_size = 50,
        .filter_btn_x = 10,
        .list_x = -18,
        .list_y = 40,
        .list_w = 620,
        .list_h = 400,
        .title_font = &lv_font_montserrat_36,
        .header_icon_font = &FilMachineFontIcons_50,
    },

    .settings = {
        .row_left_x = -15,
        .row_gap_y = 2,
        .row_h = 60,
        .slider_h = 70,
        .toggle_switch_w = 80,
        .toggle_switch_h = 45,
        .row_w = 600,
        .textarea_w = 140,
        .textarea_h = 40,
        .row_label_x = -5,
        .row_label_y = 0,
        .switch_x = 0,
        .switch_y = 0,
        .slider_x_offset = 0,
        .section_label_x = -7,
        .section_label_y = -5,
        .section_line_x = 0,
        .section_line_y = 37,
        .scroll_x = -18,
        .scroll_y = 40,
        .scroll_w = 620,
        .scroll_h = 400,
        .tune_button_x = 5,
        .tune_button_y = 0,
        .slider_y = 28,
        .slider_w = 490,
        .row_value_x = 5,
        .row_value_y = -10,
        .textarea_x = 5,
        .textarea_y = 0,
        .section_padding = 2,
        .help_icon_x = 2,
        .help_icon_y = -3,
        .section_title_font = &lv_font_montserrat_36,
        .label_font = &lv_font_montserrat_30,
        .value_font = &lv_font_montserrat_30,
        .button_font = &lv_font_montserrat_26,
        .radio_font = &lv_font_montserrat_28,
        .radio_size = 38,
        .textarea_font = &lv_font_montserrat_24,
    },

    .process_detail = {
        .modal_w = 0,
        .modal_h = 0,
        .title_y = -15,
        .title_line_w = 590,
        .title_line_y = 35,
        .close_w = 53, .close_h = 53,
        .close_x = 7,
        .close_y = -10,
        .name_x = -5,
        .name_y = 0,
        .name_w = 690,
        .name_h = 60,
        .name_textarea_x = -30,
        .name_textarea_y = -40,
        .name_textarea_w = 690,
        .steps_label_x = 140,
        .steps_label_y = 38,
        .steps_x = -15,
        .steps_y = 80,
        .steps_w = 415,
        .steps_h = 372,
        .new_step_x = 360,
        .new_step_y = 80,
        .new_step_btn_w = 40, .new_step_btn_h = 40,
        .info_label_x = -115,
        .info_label_y = 38,
        .info_x = 410,
        .info_y = 80,
        .info_w = 360,
        .info_h = 290,
        .info_content_x = -20,
        .temp_ctrl_y = -20,
        .temp_ctrl_switch_x = 20,
        .temp_switch_w = 80,
        .temp_switch_h = 45,
        .temp_row_y = 34,
        .temp_row_h = 65,
        .temp_label_x = -10,
        .temp_textarea_x = 200,
        .temp_textarea_w = 80,
        .temp_unit_x = 285,
        .tolerance_row_y = 95,
        .total_time_y = 160,
        .total_time_h = 42,
        .info_padding = 8,
        .color_container_x = -22,
        .color_container_y = 209,
        .color_container_w = 160,
        .color_container_h = 60,
        .color_label_x = 72,
        .bw_icon_x = -8,
        .total_label_x = 0,
        .preferred_x = 210,
        .preferred_y = 210,
        .save_x = -170,
        .save_y = 15,
        .save_w = 175,
        .save_h = 70,
        .run_x = 15,
        .run_y = 15,
        .run_w = 175,
        .run_h = 70,
        .title_x = 0,
        .title_line_x = 0,
        .form_label_y = 0,
        .container_x = 0,
        .container_y = 0,
        .title_font = &lv_font_montserrat_40,
        .name_font = &lv_font_montserrat_40,
        .section_font = &lv_font_montserrat_30,
        .button_icon_font = &FilMachineFontIcons_50,
        .close_icon_font = &FilMachineFontIcons_30,
        .label_font = &lv_font_montserrat_30,
        .value_font = &lv_font_montserrat_30,
        .text_area_font = &lv_font_montserrat_26,
        .film_icon_font = &FilMachineFontIcons_50,
    },

    .step_detail = {
        .modal_w = 510,
        .modal_h = 470,
        .title_y = -10,
        .title_line_w = 470,
        .title_line_y = 35,
        .form_row_x = -15,
        .form_row_w = 500,
        .form_row_h = 60,
        .row_label_x = -10,
        .dropdown_list_h = 60,
        .source_row_extra_w = 15,
        .name_y = 40,
        .duration_y = 105,
        .type_y = 170,
        .source_y = 235,
        .discard_y = 305,
        .name_textarea_x = 95,
        .name_textarea_w = 325,
        .minutes_textarea_x = 140,
        .seconds_textarea_x = 257,
        .time_textarea_w = 80,
        .type_dropdown_x = 75,
        .type_dropdown_w = 220,
        .type_icon_x = 290,
        .source_dropdown_x = 100,
        .source_dropdown_w = 110,
        .source_temp_label_x = 220,
        .source_temp_icon_x = 305,
        .source_temp_value_x = 340,
        .source_temp_value_y = 1,
        .type_dropdown_y = 2,
        .source_dropdown_y = 2,
        .discard_label_x = -10,
        .discard_switch_x = 195,
        .discard_switch_w = 80,
        .discard_switch_h = 45,
        .save_x = 10,
        .save_y = 10,
        .save_w = 170,
        .save_h = 65,
        .cancel_x = -10,
        .cancel_y = 10,
        .cancel_w = 170,
        .cancel_h = 65,
        .title_x = 0,
        .title_line_x = 0,
        .container_x = 0,
        .container_y = 0,
        .title_font = &lv_font_montserrat_36,
        .label_font = &lv_font_montserrat_30,
        .value_font = &lv_font_montserrat_30,
        .button_font = &lv_font_montserrat_30,
        .info_icon_font = &FilMachineFontIcons_40,
    },

    .checkup = {
        .stage_panel_w = 380,
        .stage_panel_h = 400,
        .stage_panel_x = -22,
        .stage_panel_y = -22,
        .stage_panel_inset = -22,
        .close_btn_w = 53,
        .close_btn_h = 53,
        .close_x = 7,
        .close_y = -10,
        .process_name_x = -20,
        .process_name_y = -25,
        .process_name_w = 700,      
        .process_name_h = 55,       
        .process_name_label_x = -10,
        .process_name_label_y = -8,
        .process_name_label_w = 700, 
        .left_panel_x = -10,
        .left_panel_y = 48,
        .left_panel_w = 380,
        .left_panel_h = 400,
        .step_panel_x = 384,
        .step_panel_y = 48,
        .step_panel_w = 380,
        .step_panel_h = 400,
        .left_title_x = -10,
        .left_title_y = -15,
        .left_body_intro_y = 32,
        .left_row_x = -10,
        .left_row_w = 355,          
        .left_row_h = 68,
        .left_water_fill_row_y = 60,
        .left_reach_temp_row_y = 135,
        .left_tank_film_row_y = 210,
        .left_status_icon_x = -20,
        .left_status_label_x = 10,  
        .left_status_label_w = 320,  
        .processing_row_w = 365,    
        .processing_source_row_y = 22,    
        .processing_temp_ctrl_row_y = 93,
        .processing_water_temp_row_y = 164,   
        .processing_next_step_row_y = 235,   
        .processing_row_value_x = 10,
        .processing_next_step_w = 175, 
        .processing_stop_y = 10,
        .processing_stop_left_x = -10,
        .processing_stop_right_x = 10,
        .stage_title_w = 383,
        .stage_title_x = -10,
        .tank_size_label_x = 0,
        .tank_size_label_y = 55,
        .chem_volume_label_x = 0,
        .chem_volume_label_y = 165,
        .stage_title_y = -8,
        .stage_tank_size_textarea_x = 0,
        .stage_tank_size_textarea_y = 95,
        .stage_chem_volume_textarea_x = 0,
        .stage_chem_volume_textarea_y = 205,
        .stage_textarea_w = 167,
        .stage_button_x = 0,
        .stage_button_y = 10,
        .fill_label_x = 0,
        .fill_label_w = 380,
        .fill_label_y = -20,
        .reach_title_w = 350,
        .reach_title_y = -60,
        .target_temp_container_x = 0,
        .target_temp_container_y = 0,
        .target_title_w = 333,
        .target_title_h = 150,
        .target_title_x = 0,
        .target_title_y = -40,
        .target_title_value_x = 0,
        .target_title_value_y = 10,
        .target_tolerance_x = 0,
        .target_tolerance_y = 55,
        .continue_button_w = 250,
        .target_temp_y = -100,
        .target_temp_w = 167,
        .target_temp_h = 100,
        .target_temp_left_x = 0,
        .target_temp_right_x = 0,
        .target_temp_label_x = 0,
        .target_temp_label_y = -15,
        .target_temp_value_x = 0,
        .target_temp_value_y = 20,
        .heater_status_x = 0,
        .heater_status_y = -70,
        .film_box_w = 333,
        .film_box_h = 120,
        .film_tank_present_box_x = 0,
        .film_tank_present_box_y = -55,
        .film_rotating_box_x = 0,
        .film_rotating_box_y = 40,
        .film_label_x = 0,
        .film_label_y = -15,
        .film_value_x = 0,
        .film_value_y = 20,
        .processing_container_x = -22,
        .processing_container_y = -22,
        .processing_container_w = 380,
        .processing_container_h = 400,
        .processing_arc_size = 355,
        .processing_arc_width = 22,
        .processing_arc_center_x = 0,
        .processing_arc_center_y = 2,
        .processing_time_x = 0,
        .processing_time_y = -60,
        .processing_step_name_x = 0,
        .processing_step_name_y = -10,
        .processing_step_name_w = 283,
        .processing_step_time_y = 14,
        .processing_step_arc_size = 355,
        .processing_step_arc_center_x = 0,
        .processing_step_arc_center_y = 222,
        .processing_step_kind_x = 0,
        .processing_step_kind_y = 110,
        .processing_pump_arc_size = 355,
        .processing_complete_x = 0,
        .processing_complete_y = -30,
        .left_status_icon_y = 0,
        .left_status_label_y = 0,
        .processing_row_value_y = 0,
        .action_btn_w = 170, .action_btn_h = 65,
        .close_icon_font = &FilMachineFontIcons_30,
        .process_name_font = &lv_font_montserrat_40,   
        .left_title_font = &lv_font_montserrat_30,     
        .left_body_font = &lv_font_montserrat_26,      
        .left_value_font = &lv_font_montserrat_28,     
        .action_btn_font = &lv_font_montserrat_28,         
        .stage_title_font = &lv_font_montserrat_32,    
        .stage_label_font = &lv_font_montserrat_30,    
        .stage_value_font = &lv_font_montserrat_36,
        .heater_status_font = &lv_font_montserrat_26,          
        .status_icon_font = &FilMachineFontIcons_30,
        .target_title_font = &lv_font_montserrat_30,   
        .target_value_font = &lv_font_montserrat_64,
    },



    .roller_popup = {
        .title_x = 0,
        .title_y = -10,
        .title_line_x = 0,
        .title_line_y = 35,
        .wheel_container_x = 0,
        .wheel_container_y = 45,
        .wheel_x = 0,
        .wheel_w = 300,
        .wheel_visible_rows = 4,
        .confirm_btn_x = 0,
        .confirm_btn_y = 5,
        .title_font = &lv_font_montserrat_36,
        .confirm_btn_font = &lv_font_montserrat_24,
        .confirm_btn_w = 150,
        .confirm_btn_h = 50,
        .wheel_font = &lv_font_montserrat_48,
        .wheel_normal_font = &lv_font_montserrat_30,
    },

    .clean_popup = {
        .title_x = 0,
        .title_y = -10,
        .title_line_x = 0,
        .title_line_y = 35,
        .settings_x = 0,
        .settings_y = 95,
        .subtitle_x = 0,
        .subtitle_y = -5,
        .checkbox_y = 0,
        .checkbox_label_y = 0,
        .chem_container_x = -7,
        .chem_container_y = -38,
        .chem_container_w = 490,
        .chem_container_h = 55,
        .checkbox_w = 145,
        .checkbox_h = 48,
        .chem_c1_checkbox_x = -15,
        .chem_c2_checkbox_x = 140,
        .chem_c3_checkbox_x = 295,
        .checkbox_label_x = -10,
        .checkbox_radio_size = 38,
        .spinbox_container_x = 0,
        .spinbox_container_y = 25,
        .spinbox_container_w = 490,
        .spinbox_container_h = 55,
        .spinbox_w = 35,
        .spinbox_x = 280,
        .spinbox_y = 0,
        .repeat_label_x = -10,
        .repeat_label_y = 0,
        .drain_container_x = 0,
        .drain_container_y = 88,
        .drain_container_w = 490,
        .drain_label_x = -10,
        .drain_label_y = 0,
        .drain_switch_x = 200,
        .drain_switch_y = 0,
        .drain_switch_extra_x = 175,
        .run_button_x = 15,
        .run_button_y = 10,
        .run_btn_w = 170, .run_btn_h = 65,
        .cancel_button_x = -15,
        .cancel_button_y = 10,
        .cancel_btn_w = 170, .cancel_btn_h = 65,
        .process_arc_size = 350,
        .cycle_arc_size = 290,
        .pump_arc_size = 230,
        .progress_arc_width = 22,
        .process_arc_x = 0,
        .process_arc_y = 15,
        .remaining_time_x = 0,
        .remaining_time_y = -15,
        .now_cleaning_label_x = 0,
        .now_cleaning_label_y = 15,
        .now_cleaning_value_x = 0,
        .now_cleaning_value_y = 45,
        .now_step_x = 0,
        .now_step_y = 76,
        .stop_button_x = 0,
        .stop_button_y = 20,
        .stop_btn_w = 170, .stop_btn_h = 65,
        .title_font = &lv_font_montserrat_36,
        .subtitle_font = &lv_font_montserrat_30,
        .label_font = &lv_font_montserrat_30,
        .button_font = &lv_font_montserrat_30,
        .time_font = &lv_font_montserrat_36,
        .value_font = &lv_font_montserrat_26,
        .step_font = &lv_font_montserrat_22,
    },

    .drain_popup = {
        .title_x = 0,
        .title_y = -10,
        .title_line_x = 0,
        .title_line_y = 35,
        .confirm_x = 0,
        .confirm_y = 95,
        .confirm_info_x = 0,
        .confirm_info_w = 500,
        .confirm_info_y = -5,
        .start_cancel_btn_x = 15,
        .start_cancel_btn_y = 10,
        .action_btn_w = 170, .action_btn_h = 65,
        .progress_container_x = 0,
        .progress_container_y = 95,
        .progress_container_pad = 10,
        .tank_bar_w = 90,
        .tank_bar_h = 130,
        .tank_bar_gap = 40,
        .tank_bars_area_w = 520,
        .tank_bar_y = 2,
        .tank_label_y = 10,
        .drain_status_x = 0,
        .drain_status_w = 500,
        .drain_status_y = 172,
        .waste_label_x = 0,
        .waste_label_y = 205,
        .remaining_time_x = 0,
        .remaining_time_y = 222,
        .stop_btn_x = 0,
        .stop_btn_y = 262,
        .stop_btn_w = 170, .stop_btn_h = 65,
        .tank_bar_radius = 10,
        .title_font = &lv_font_montserrat_36,
        .info_font = &lv_font_montserrat_26,
        .bar_label_font = &lv_font_montserrat_24,
        .status_font = &lv_font_montserrat_30,
        .secondary_font = &lv_font_montserrat_30,
        .button_font = &lv_font_montserrat_30,
    },



    .tools = {
        .section_label_x = -7,
        .section_title_y_maintenance = -5,
        .section_title_y_utilities = 222,
        .section_title_y_statistics = 394,
        .section_title_y_update = 694,
        .section_title_y_software = 896,
        .section_line_y_maintenance = 37,
        .section_line_y_utilities = 274,
        .section_line_y_statistics = 446,
        .section_line_y_update = 746,
        .section_line_y_software = 948,
        .item_row_x = -15,
        .item_row_w = 600,
        .action_row_h = 55,
        .stat_row_h = 60,
        .item_label_x = -5,
        .item_label_y = 0,
        .item_btn_x = 0,
        .maintenance_clean_y = 53,
        .maintenance_drain_y = 110,
        .maintenance_selfcheck_y = 167,
        .utilities_import_y = 282,
        .utilities_export_y = 339,
        .statistics_completed_y = 454,
        .statistics_total_time_y = 514,
        .statistics_clean_cycles_y = 574,
        .statistics_stopped_y = 634,
        .update_sd_y = 754,
        .update_wifi_y = 811,
        .software_version_y = 956,
        .software_serial_y = 1016,
        .software_credits_y = 1076,
        .help_icon_x = 2,
        .help_icon_y = -3,
        .credit_button_x = 5,
        .action_btn_w = 140,
        .action_btn_h = 45,
        .credit_button_h = 60,
        .credit_button_w = 110,
        .section_line_x = 0,
        .section_font = &lv_font_montserrat_36,
        .item_font = &lv_font_montserrat_30,
        .button_icon_font = &FilMachineFontIcons_40,
        .credit_button_font = &lv_font_montserrat_26,
    },

    .popups = {
        .message_w = 560,
        .message_h = 380,
        .message_title_line_w = 400,
        .roller_w = 500,
        .roller_h = 380,
        .roller_title_line_w = 400,
        .roller_content_w = 440,
        .roller_content_h = 280,
        .roller_wheel_h = 190,
        .roller_wheel_y = -40,
        .filter_w = 575,
        .filter_h = 330,
        .filter_title_line_w = 380,
        .clean_w = 530,
        .clean_h = 450,
        .clean_title_line_w = 380,
        .clean_settings_w = 510,
        .clean_settings_h = 250,
        .clean_process_w = 510,
        .clean_process_h = 340,
        .drain_w = 560,
        .drain_h = 430,
        .drain_title_line_w = 400,
        .drain_confirm_w = 540,
        .drain_confirm_h = 240,
        .drain_process_w = 540,
        .drain_process_h = 350,
        .selfcheck_w = 670,
        .selfcheck_h = 430,
        .selfcheck_title_line_w = 500,
        .ota_wifi_w = 580,
        .ota_wifi_h = 400,
        .ota_progress_w = 520,
        .ota_progress_h = 320,
        .ota_status_w = 400,
        .ota_percent_w = 400,
        .ota_progress_bar_w = 430,
        .ota_progress_bar_h = 30,
        .splash_w = 500,
        .splash_h = 430,
        .splash_title_line_w = 380,
    },

    .splash_popup = {
        .title_y = -10,
        .title_line_y = 35,
        .default_switch_y = 53,
        .random_switch_y = 111,
        .switch_row_w = 450,
        .options_x = 5,
        .options_y = 169,
        .options_h = 171,
        .options_w = 460,
        .row_h = 45,
        .row_gap = 13,
        .label_x = 10,
        .label_y_offset = 6,
        .roller_x = 0,
        .roller_w = 240,
        .roller_h = 42,
        .roller_visible_rows = 1,
        .slider_w = 180,
        .slider_x = -10,
        .slider_y_offset = 10,
        .title_x = 0,
        .title_line_x = 0,
        .switch_row_x = 0,
        .switch_x = 0,
        .switch_y = 0,
        .close_btn_x = 0,
        .close_btn_w = 170,
        .close_btn_h = 55,
        .close_btn_y = -13,
        .switch_label_y = 0,
        .x_close_w = 53,
        .x_close_h = 53,
        .x_close_x = 7,
        .x_close_y = -10,
        .overlay_opa = 170,
        .title_font = &lv_font_montserrat_36,
        .label_font = &lv_font_montserrat_24,
        .button_font = &lv_font_montserrat_26,
        .value_font = &lv_font_montserrat_22,
        .close_icon_font = &FilMachineFontIcons_30,
    },

    .splash_screen = {
        .subtitle_x = 0,
        .subtitle_y = 8,
        .version_x = -10,
        .version_y = -6,
        .play_icon_x = -80,
        .play_icon_y = -80,
        .play_hit_w = 140,
        .play_hit_h = 140,
        .play_hit_x = -15,
        .play_hit_y = -15,
    },

    .filter_popup = {
        .title_x = 0,
        .title_y = -10,
        .title_line_x = 0,
        .title_line_y = 35,
        .close_x = 7,
        .close_y = -10,
        .close_w = 53, .close_h = 53,
        .close_icon_size = 30,
        .name_container_x = 10,
        .name_container_y = 45,
        .name_container_w = 500,
        .name_container_h = 75,
        .name_label_x = 5,
        .name_label_y = 0,
        .name_textarea_x = 130,
        .name_textarea_y = 0,
        .name_textarea_w = 350,
        .color_row_y = 10,
        .bw_row_y = 10,
        .preferred_row_y = 10,
        .filter_options_container_x = 10,
        .filter_options_container_w = 470,
        .filter_options_container_h = 100,
        .color_box_x = 5,
        .color_box_y = -22,
        .bw_box_x = 163,
        .bw_box_y = 22,
        .preferred_box_x = 304,
        .filter_box_default_w = 195,
        .color_box_w = 160,
        .bw_box_w = 150,
        .preferred_box_w = 230,
        .filter_box_h = 45,
        .filter_label_x = -10,
        .color_radio_x = 0,
        .bw_radio_x = 0,
        .preferred_radio_x = 0,
        .option_radio_size = 38,
        .preferred_switch_x = 250,
        .filter_label_offset_x = 5,
        .filter_label_offset_y = 0,
        .apply_reset_btn_y = 10,
        .apply_reset_btn_x = 15,
        .action_btn_w = 170, .action_btn_h = 65,
        .title_font = &lv_font_montserrat_36,
        .label_font = &lv_font_montserrat_30,
        .button_font = &lv_font_montserrat_30,
        .close_icon_font = &FilMachineFontIcons_30,
        .textarea_font = &lv_font_montserrat_30,
        .radio_font = &lv_font_montserrat_26,
    },

    .selfcheck_popup = {
        .title_x = 0,
        .title_y = -10,
        .title_line_x = 0,
        .title_line_y = 35,
        .close_x = 7,
        .close_y = -10,
        .close_icon_size = 30,
        .close_w = 53, .close_h = 53,
        .left_panel_x = -5,
        .left_panel_y = 38,
        .left_panel_w = 240,
        .left_panel_h = 370,
        .tasks_label_x = 5,
        .tasks_label_y = 0,
        .phase_icon_x = 5,
        .phase_name_x = 30,
        .phase_row_y = 40,
        .phase_row_gap = 44,
        .right_panel_x = 185,
        .right_panel_y = 38,
        .right_panel_w = 470,
        .right_panel_h = 370,
        .phase_title_x = 0,
        .phase_title_w = 450,
        .phase_title_y = 0,
        .phase_desc_x = 0,
        .phase_desc_w = 450,
        .phase_desc_y = 45,
        .phase_status_x = 0,
        .phase_status_w = 450,
        .phase_status_y = 120,
        .phase_timer_x = 0,
        .phase_timer_y = 195,
        .progress_bar_x = 0,
        .progress_bar_w = 440,
        .progress_bar_h = 38,
        .progress_bar_y = 235,
        .control_btn_w = 135,
        .control_btn_h = 55,
        .control_btn_y = 305,
        .stop_button_x = 0,
        .start_button_x = 150,
        .advance_button_x = 300,
        .title_font = &lv_font_montserrat_36,
        .tasks_font = &lv_font_montserrat_22,
        .phase_icon_font = &FilMachineFontIcons_30,
        .phase_name_font = &lv_font_montserrat_20,
        .phase_title_font = &lv_font_montserrat_28,
        .phase_desc_font = &lv_font_montserrat_26,
        .phase_status_font = &lv_font_montserrat_26,
        .control_btn_font = &lv_font_montserrat_26,
        .advance_button_font = &lv_font_montserrat_26,
        .close_icon_font = &FilMachineFontIcons_30,
    },

    .ota_popup = {
        .title_x = 0,
        .title_y = -10,
        .title_line_x = 0,
        .title_line_y = 35,
        .close_x = 7,
        .close_y = -10,
        .close_icon_size = 30,
        .close_w = 53, .close_h = 53,
        .ip_label_x = 0,
        .ip_label_w = 500,
        .ip_label_y = 55,
        .pin_label_x = 0,
        .pin_label_w = 500,
        .pin_label_y = 120,
        .status_label_x = 0,
        .status_label_w = 500,
        .status_label_y = 190,
        .progress_x = 0,
        .progress_h = 30,
        .progress_y = 240,
        .progress_radius = 6,
        .progress_status_x = 0,
        .progress_status_y = 55,
        .progress_bar_y = 118,
        .percent_x = 0,
        .percent_y = 168,
        .progress_popup_radius = 8,
        .title_font = &lv_font_montserrat_36,
        .close_icon_font = &FilMachineFontIcons_30,
        .ip_font = &lv_font_montserrat_30,
        .pin_font = &lv_font_montserrat_40,
        .status_font = &lv_font_montserrat_26,
        .progress_status_font = &lv_font_montserrat_26,
        .percent_font = &lv_font_montserrat_30,
    },

    .wifi_popup = {
        .status_y = 50,
        .scan_btn_w = 45,
        .scan_btn_h = 45,
        .scan_btn_y = 45,
        .list_y = 100,
        .list_h = 180,
        .autoconnect_container_w_pct = 55,
        .autoconnect_container_h = 45,
        .autoconnect_container_x = 10,
        .autoconnect_container_y = -10,
        .autoconnect_switch_gap = 10,
        .connect_btn_w = 180,
        .connect_btn_h = 65,
        .connect_btn_x = 7,
        .connect_btn_y = 5,
        .list_item_h = 35,
        .list_w_pct = 90,
        .list_pad_row = 4,
        .list_pad_all = 5,
        .list_border_w = 1,
        .list_radius = 5,
        .list_item_radius = 4,
        .list_item_pad_x = 8,
        .status_w_pct = 80,
        .title_line_w = 200,
        .spinner_size = 40,
        .spinner_arc_w = 4,
        .status_font = &lv_font_montserrat_22,
        .list_font = &lv_font_montserrat_22,
        .scan_btn_font = &lv_font_montserrat_26,
        .connect_btn_font = &lv_font_montserrat_30,
        .autoconnect_font = &lv_font_montserrat_26,
    },

    .message_popup = {
        .title_x = 0,
        .title_y = -10,
        .title_line_x = 0,
        .title_line_y = 35,
        .text_container_x = 0,
        .text_container_y = 40,
        .text_container_w = 520,
        .text_container_h = 280,
        .text_w = 500,
        .close_btn_x = 7,
        .close_btn_y = -10,
        .close_w = 53, .close_h = 53,
        .secondary_btn_x = 15,
        .primary_btn_x = 15,
        .action_btn_y = 10,
        .action_btn_w = 170, .action_btn_h = 65,
        .title_font = &lv_font_montserrat_36,
        .text_font = &lv_font_montserrat_28,
        .button_font = &lv_font_montserrat_30,
        .close_icon_font = &FilMachineFontIcons_30,
    },

    .process_element = {
        .card_w = 655,
        .card_h = 130,
        .card_x = -10,
        .list_start_y = -20,
        .swipe_offset = 60,
        .delete_btn_w = 80,
        .delete_btn_h = 128,
        .delete_btn_x = -22,
        .delete_btn_y = -18,
        .delete_icon_x = -10,
        .card_content_w = 540,
        .card_content_h = 126,
        .card_content_x = 40,
        .card_content_y = -16,
        .name_w = 400,
        .name_x = -10,
        .name_y = -18,
        .temp_icon_x = -15,
        .temp_icon_y = 35,
        .temp_value_x = 10,
        .temp_value_y = 35,
        .time_icon_x = 90,
        .time_icon_y = 35,
        .time_value_x = 120,
        .time_value_y = 35,
        .time_icon_no_temp_x = -10,
        .time_value_no_temp_x = 20,
        .type_icon_x = 7,
        .type_icon_y = 0,
        .preferred_icon_x = 25,
        .preferred_icon_y = 0,
        .delete_icon_y = 0,
        .time_width_margin = 18,
        .name_font = &lv_font_montserrat_36,
        .detail_font = &lv_font_montserrat_28,
        .detail_icon_font = &FilMachineFontIcons_30,
        .type_icon_font = &FilMachineFontIcons_50,
        .delete_icon_font = &FilMachineFontIcons_50,
    },

    .step_element = {
        .card_w = 610,
        .card_h = 123,
        .card_x = -13,
        .list_start_y = -18,
        .swipe_offset = 55,
        .delete_btn_w = 70,
        .delete_btn_h = 119,
        .delete_btn_x = -22,
        .delete_btn_y = -21,
        .delete_icon_x = -5,
        .delete_icon_y = 0,
        .edit_btn_w = 70,
        .edit_btn_h = 115,
        .edit_btn_x = 480,
        .edit_btn_y = -21,
        .edit_icon_x = 5,
        .edit_icon_y = 0,
        .card_content_w = 398,
        .card_content_h = 115,
        .card_content_x = 34,
        .card_content_y = -19,
        .type_icon_x = -9,
        .type_icon_y = -18,
        .name_w = 310,
        .name_x = 20,
        .name_y = -18,
        .time_icon_x = -9,
        .time_icon_y = 26,
        .time_value_x = 18,
        .time_value_y = 26,
        .source_w = 220,
        .source_x = 160,
        .source_y = 26,
        .discard_icon_x = 15,
        .discard_icon_y = 26,
        .name_font = &lv_font_montserrat_30,
        .detail_font = &lv_font_montserrat_30,
        .detail_icon_font = &FilMachineFontIcons_30,
        .type_icon_font = &FilMachineFontIcons_30,
        .delete_icon_font = &FilMachineFontIcons_50,
        .edit_icon_font = &FilMachineFontIcons_50,
    },

    .buttons = {
        .process_h = 45,
        .process_w = 110,
        .start_h = 100,
        .start_w = 160,
        .msgbox_btn_h = 65,
        .msgbox_btn_w = 170,
        .popup_close_h = 53,
        .popup_close_w = 53,
        .tune_h = 50,
        .tune_w = 140,
        .logo_h = 100,
        .logo_w = 115,
    },

    .keyboard = {
        .textarea_y = 10,
        .textarea_h = 80,
        .keyboard_font = &lv_font_montserrat_26,
        .textarea_font = &lv_font_montserrat_30,
    },

    .clean_drain_container_h = 55,
    .clean_spinbox_btn_offset = 5,
    .title_line_width = 2,
    .element_border_width = 8,
    .element_shadow_width = 8,
    .element_shadow_spread = 5,
    .selfcheck_progress_radius = 4,
};

