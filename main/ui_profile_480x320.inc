static const ui_profile_t ui_profile_480x320 __attribute__((unused)) = {
    .common = {
        .top_margin = 7,
        .sidebar_x = 5,
        .sidebar_w = 130,
        .content_x = 140,
        .content_y = 7,
        .content_w = 335,
        .content_h = 303,
        .title_line_x = 0,
        .title_line_w = 310,
        .title_line_y = 30,
    },


    .menu = {
        .tab_w = 130,
        .tab_h = 97,
        .tab_gap = 6,
        .tab_processes_y = 7,
        .tab_settings_y = 110,
        .tab_tools_y = 213,
        .tab_icon_offset_x = 0,
        .tab_icon_offset_y = -10,
        .tab_label_offset_x = 0,
        .tab_label_offset_y = 29,
        .tab_icon_font = &FilMachineFontIcons_40,
        .tab_label_font = &lv_font_montserrat_18,
    },

    .processes = {
        .add_btn_w = 200,
        .add_btn_h = 45,
        .add_btn_x = -20,
        .add_btn_y = -12,
        .title_label_x = -5,
        .title_label_y = -5,
        .add_icon_x = 5,
        .add_icon_y = 0,
        .filter_btn_size = 45,
        .filter_btn_x = 10,
        .list_x = -18,
        .list_y = 31,
        .list_w = 335,
        .list_h = 254,
        .title_font = &lv_font_montserrat_28,
        .header_icon_font = &FilMachineFontIcons_30,
    },

    .settings = {
        .row_left_x = -15,
        .row_gap_y = 2,
        .row_h = 55,
        .slider_h = 65,
        .toggle_switch_w = 50,
        .toggle_switch_h = 25,
        .row_w = 330,
        .textarea_w = 100,
        .textarea_h = 40,
        .row_label_x = -5,
        .row_label_y = 0,
        .switch_x = 0,
        .switch_y = 0,
        .slider_x_offset = 0,
        .section_label_x = -7,
        .section_label_y = -5,
        .section_line_x = 0,
        .section_line_y = 30,
        .scroll_x = -22,
        .scroll_y = 31,
        .scroll_w = 335,
        .scroll_h = 254,
        .tune_button_x = 5,
        .tune_button_y = 0,
        .slider_y = 23,
        .slider_w = 160,
        .row_value_x = 5,
        .row_value_y = -10,
        .textarea_x = 5,
        .textarea_y = 0,
        .section_padding = 2,
        .help_icon_x = 2,
        .help_icon_y = -3,
        .section_title_font = &lv_font_montserrat_28,
        .label_font = &lv_font_montserrat_20,
        .value_font = &lv_font_montserrat_22,
        .button_font = &lv_font_montserrat_18,
        .radio_font = &lv_font_montserrat_18,
        .radio_size = 27,
        .textarea_font = &lv_font_montserrat_20,
    },

    .process_detail = {
        .modal_w = 0,
        .modal_h = 0,
        .title_y = -10,
        .title_line_w = 310,
        .title_line_y = 23,
        .close_w = 36,
        .close_h = 36,
        .close_x = 7,
        .close_y = -10,
        .name_x = -10,
        .name_y = -15,
        .name_w = 415,
        .name_h = 40,
        .name_textarea_x = -20,
        .name_textarea_y = -28,
        .name_textarea_w = 415,
        .steps_label_x = 0,
        .steps_label_y = 25,
        .steps_x = -10,
        .steps_y = 55,
        .steps_w = 250,
        .steps_h = 240,
        .new_step_x = 212,
        .new_step_y = 55,
        .new_step_btn_w = 27,
        .new_step_btn_h = 27,
        .info_label_x = -105,
        .info_label_y = 25,
        .info_x = 245,
        .info_y = 55,
        .info_w = 210,
        .info_h = 195,
        .info_content_x = -15,
        .temp_ctrl_y = -17,
        .temp_ctrl_switch_x = 15,
        .temp_switch_w = 50,
        .temp_switch_h = 25,
        .temp_row_y = 20,
        .temp_row_h = 45,
        .temp_label_x = -15,
        .temp_textarea_x = 100,
        .temp_textarea_w = 60,
        .temp_unit_x = 160,
        .tolerance_row_y = 65,
        .total_time_y = 110,
        .total_time_h = 30,
        .info_padding = 5,
        .color_container_x = -18,
        .color_container_y = 137,
        .color_container_w = 105,
        .color_container_h = 40,
        .color_label_x = 45,
        .bw_icon_x = -5,
        .total_label_x = 0,
        .preferred_x = 120,
        .preferred_y = 143,
        .save_x = -103,
        .save_y = 10,
        .save_w = 95,
        .save_h = 40,
        .run_x = 10,
        .run_y = 10,
        .run_w = 95,
        .run_h = 40,
        .title_x = 0,
        .title_line_x = 0,
        .form_label_y = 0,
        .container_x = 0,
        .container_y = 0,
        .title_font = &lv_font_montserrat_22,
        .name_font = &lv_font_montserrat_30,
        .section_font = &lv_font_montserrat_24,
        .button_icon_font = &FilMachineFontIcons_30,
        .close_icon_font = &FilMachineFontIcons_20,
        .label_font = &lv_font_montserrat_16,
        .value_font = &lv_font_montserrat_20,
        .text_area_font = &lv_font_montserrat_18,
        .film_icon_font = &FilMachineFontIcons_30,
    },

    .step_detail = {
        .modal_w = 350,
        .modal_h = 300,
        .title_y = -10,
        .title_line_w = 310,
        .title_line_y = 23,
        .form_row_x = -15,
        .form_row_w = 325,
        .form_row_h = 40,
        .row_label_x = -10,
        .dropdown_list_h = 50,
        .source_row_extra_w = 15,
        .name_y = 30,
        .duration_y = 70,
        .type_y = 110,
        .source_y = 150,
        .discard_y = 190,
        .name_textarea_x = 70,
        .name_textarea_w = 210,
        .minutes_textarea_x = 100,
        .seconds_textarea_x = 187,
        .time_textarea_w = 60,
        .type_dropdown_x = 50,
        .type_dropdown_w = 165,
        .type_icon_x = 210,
        .source_dropdown_x = 71,
        .source_dropdown_w = 83,
        .source_temp_label_x = 165,
        .source_temp_icon_x = 227,
        .source_temp_value_x = 245,
        .source_temp_value_y = 1,
        .type_dropdown_y = 2,
        .source_dropdown_y = 2,
        .discard_label_x = -10,
        .discard_switch_x = 140,
        .discard_switch_w = 50,
        .discard_switch_h = 25,
        .save_x = 10,
        .save_y = 10,
        .save_w = 95,
        .save_h = 40,
        .cancel_x = -10,
        .cancel_y = 10,
        .cancel_w = 95,
        .cancel_h = 40,
        .title_x = 0,
        .title_line_x = 0,
        .container_x = 0,
        .container_y = 0,
        .title_font = &lv_font_montserrat_22,
        .label_font = &lv_font_montserrat_22,
        .value_font = &lv_font_montserrat_22,
        .button_font = &lv_font_montserrat_22,
        .info_icon_font = &FilMachineFontIcons_20,
    },

    .checkup = {
        .stage_panel_w = 240,
        .stage_panel_h = 265,
        .stage_panel_x = -18,
        .stage_panel_y = -18,
        .stage_panel_inset = -18,
        .close_btn_w = 36,
        .close_btn_h = 36,
        .close_x = 7,
        .close_y = -10,
        .process_name_x = -10,
        .process_name_y = -15,
        .process_name_w = 420,
        .process_name_h = 50,
        .process_name_label_x = -10,
        .process_name_label_y = -8,
        .process_name_label_w = 420,
        .left_panel_x = -10,
        .left_panel_y = 35,
        .left_panel_w = 225,
        .left_panel_h = 265,
        .step_panel_x = 217,
        .step_panel_y = 35,
        .step_panel_w = 240,
        .step_panel_h = 265,
        .left_title_x = -10,
        .left_title_y = -8,
        .left_body_intro_y = 17,
        .left_row_x = -10,
        .left_row_w = 195,
        .left_row_h = 45,
        .left_water_fill_row_y = 45,
        .left_reach_temp_row_y = 90,
        .left_tank_film_row_y = 135,
        .left_status_icon_x = -15,
        .left_status_label_x = 2,
        .left_status_label_w = 168,
        .processing_row_w = 215,
        .processing_source_row_y = 17,
        .processing_temp_ctrl_row_y = 62,
        .processing_water_temp_row_y = 107,
        .processing_next_step_row_y = 152,
        .processing_row_value_x = 10,
        .processing_next_step_w = 105,
        .processing_stop_y = 10,
        .processing_stop_left_x = -10,
        .processing_stop_right_x = 10,
        .stage_title_w = 230,
        .stage_title_x = -10,
        .tank_size_label_x = 0,
        .tank_size_label_y = 30,
        .chem_volume_label_x = 0,
        .chem_volume_label_y = 100,
        .stage_title_y = -8,
        .stage_tank_size_textarea_x = 0,
        .stage_tank_size_textarea_y = 55,
        .stage_chem_volume_textarea_x = 0,
        .stage_chem_volume_textarea_y = 125,
        .stage_textarea_w = 100,
        .stage_button_x = 0,
        .stage_button_y = 10,
        .fill_label_x = 0,
        .fill_label_w = 235,
        .fill_label_y = -20,
        .reach_title_w = 210,
        .reach_title_y = -60,
        .target_temp_container_x = 0,
        .target_temp_container_y = 0,
        .target_title_w = 200,
        .target_title_h = 90,
        .target_title_x = 0,
        .target_title_y = -30,
        .target_title_value_x = 0,
        .target_title_value_y = 5,
        .target_tolerance_x = 0,
        .target_tolerance_y = 30,
        .continue_button_w = 150,
        .target_temp_y = -50,
        .target_temp_w = 100,
        .target_temp_h = 80,
        .target_temp_left_x = 0,
        .target_temp_right_x = 0,
        .target_temp_label_x = 0,
        .target_temp_label_y = -15,
        .target_temp_value_x = 0,
        .target_temp_value_y = 20,
        .heater_status_x = 0,
        .heater_status_y = -35,
        .film_box_w = 200,
        .film_box_h = 80,
        .film_tank_present_box_x = 0,
        .film_tank_present_box_y = -55,
        .film_rotating_box_x = 0,
        .film_rotating_box_y = 40,
        .film_label_x = 0,
        .film_label_y = -15,
        .film_value_x = 0,
        .film_value_y = 20,
        .processing_container_x = -18,
        .processing_container_y = -18,
        .processing_container_w = 240,
        .processing_container_h = 265,
        .processing_arc_size = 220,
        .processing_arc_width = 0,
        .processing_arc_center_x = 0,
        .processing_arc_center_y = 2,
        .processing_time_x = 0,
        .processing_time_y = -60,
        .processing_step_name_x = 0,
        .processing_step_name_y = -10,
        .processing_step_name_w = 170,
        .processing_step_time_y = 14,
        .processing_step_arc_size = 220,
        .processing_step_arc_center_x = 0,
        .processing_step_arc_center_y = 139,
        .processing_step_kind_x = 0,
        .processing_step_kind_y = 69,
        .processing_pump_arc_size = 220,
        .processing_complete_x = 0,
        .processing_complete_y = -30,
        .left_status_icon_y = 0,
        .left_status_label_y = 0,
        .processing_row_value_y = 0,
        .action_btn_w = 110,
        .action_btn_h = 45,
        .close_icon_font = &FilMachineFontIcons_30,
        .process_name_font = &lv_font_montserrat_30,
        .left_title_font = &lv_font_montserrat_22,
        .left_body_font = &lv_font_montserrat_18,
        .left_value_font = &lv_font_montserrat_20,
        .action_btn_font = &lv_font_montserrat_16,
        .stage_title_font = &lv_font_montserrat_22,
        .stage_label_font = &lv_font_montserrat_18,
        .stage_value_font = &lv_font_montserrat_20,
        .heater_status_font = &lv_font_montserrat_16,
        .status_icon_font = &FilMachineFontIcons_15,
        .target_title_font = &lv_font_montserrat_20,
        .target_value_font = &lv_font_montserrat_28,
    },



    .roller_popup = {
        .title_x = 0,
        .title_y = -10,
        .title_line_x = 0,
        .title_line_y = 23,
        .wheel_container_x = 0,
        .wheel_container_y = 30,
        .wheel_x = 0,
        .wheel_w = 140,
        .wheel_visible_rows = 4,
        .confirm_btn_x = 0,
        .confirm_btn_y = 0,
        .title_font = &lv_font_montserrat_22,
        .confirm_btn_font = &lv_font_montserrat_18,
        .confirm_btn_w = 90,
        .confirm_btn_h = 40,
        .wheel_font = &lv_font_montserrat_30,
        .wheel_normal_font = &lv_font_montserrat_16,
    },

    .clean_popup = {
        .title_x = 0,
        .title_y = -10,
        .title_line_x = 0,
        .title_line_y = 23,
        .settings_x = 0,
        .settings_y = 63,
        .subtitle_x = 0,
        .subtitle_y = -12,
        .chem_container_x = -7,
        .chem_container_y = -65,
        .chem_container_w = 300,
        .chem_container_h = 50,
        .checkbox_w = 100,
        .checkbox_h = 40,
        .chem_c1_checkbox_x = -15,
        .chem_c2_checkbox_x = 85,
        .chem_c3_checkbox_x = 185,
        .checkbox_y = 0,
        .checkbox_label_x = -10,
        .checkbox_label_y = 0,
        .checkbox_radio_size = 27,
        .spinbox_container_x = 0,
        .spinbox_container_y = -15,
        .spinbox_container_w = 300,
        .spinbox_container_h = 50,
        .spinbox_w = 30,
        .spinbox_x = 185,
        .spinbox_y = 0,
        .repeat_label_x = -10,
        .repeat_label_y = 0,
        .drain_container_x = 0,
        .drain_container_y = 35,
        .drain_container_w = 300,
        .drain_label_x = -10,
        .drain_label_y = 0,
        .drain_switch_x = 112,
        .drain_switch_y = 0,
        .drain_switch_extra_x = 108,
        .run_button_x = 10,
        .run_button_y = 10,
        .run_btn_w = 110,
        .run_btn_h = 45,
        .cancel_button_x = -10,
        .cancel_button_y = 10,
        .cancel_btn_w = 110,
        .cancel_btn_h = 45,
        .process_arc_size = 230,
        .process_arc_x = 0,
        .cycle_arc_size = 200,
        .pump_arc_size = 170,
        .progress_arc_width = 0,
        .process_arc_y = 5,
        .remaining_time_x = 0,
        .remaining_time_y = -25,
        .now_cleaning_label_x = 0,
        .now_cleaning_label_y = 0,
        .now_cleaning_value_x = 0,
        .now_cleaning_value_y = 25,
        .now_step_x = 0,
        .now_step_y = 47,
        .stop_button_x = 0,
        .stop_button_y = 10,
        .stop_btn_w = 110,
        .stop_btn_h = 45,
        .title_font = &lv_font_montserrat_22,
        .subtitle_font = &lv_font_montserrat_18,
        .label_font = &lv_font_montserrat_22,
        .button_font = &lv_font_montserrat_22,
        .time_font = &lv_font_montserrat_28,
        .value_font = &lv_font_montserrat_22,
        .step_font = &lv_font_montserrat_18,
    },

    .drain_popup = {
        .title_x = 0,
        .title_y = -10,
        .title_line_x = 0,
        .title_line_y = 23,
        .confirm_x = 0,
        .confirm_y = 63,
        .confirm_info_x = 0,
        .confirm_info_w = 280,
        .confirm_info_y = -5,
        .start_cancel_btn_x = 10,
        .start_cancel_btn_y = 10,
        .action_btn_w = 110,
        .action_btn_h = 45,
        .progress_container_x = 0,
        .progress_container_y = 63,
        .progress_container_pad = 5,
        .tank_bar_w = 42,
        .tank_bar_h = 85,
        .tank_bar_gap = 22,
        .tank_bars_area_w = 310,
        .tank_bar_y = 2,
        .tank_label_y = 5,
        .drain_status_x = 0,
        .drain_status_w = 300,
        .drain_status_y = 112,
        .waste_label_x = 0,
        .waste_label_y = 134,
        .remaining_time_x = 0,
        .remaining_time_y = 156,
        .stop_btn_x = 0,
        .stop_btn_y = 182,
        .stop_btn_w = 110,
        .stop_btn_h = 45,
        .tank_bar_radius = 6,
        .title_font = &lv_font_montserrat_22,
        .info_font = &lv_font_montserrat_20,
        .bar_label_font = &lv_font_montserrat_18,
        .status_font = &lv_font_montserrat_20,
        .secondary_font = &lv_font_montserrat_18,
        .button_font = &lv_font_montserrat_22,
    },



    .tools = {
        .section_label_x = -7,
        .section_title_y_maintenance = -5,
        .section_title_y_utilities = 185,
        .section_title_y_statistics = 325,
        .section_title_y_update = 525,
        .section_title_y_software = 685,
        .section_line_y_maintenance = 30,
        .section_line_y_utilities = 220,
        .section_line_y_statistics = 360,
        .section_line_y_update = 560,
        .section_line_y_software = 720,
        .item_row_x = -15,
        .item_row_w = 330,
        .action_row_h = 50,
        .stat_row_h = 40,
        .item_label_x = -5,
        .item_label_y = 0,
        .item_btn_x = 0,
        .maintenance_clean_y = 35,
        .maintenance_drain_y = 85,
        .maintenance_selfcheck_y = 135,
        .utilities_import_y = 225,
        .utilities_export_y = 275,
        .statistics_completed_y = 365,
        .statistics_total_time_y = 405,
        .statistics_clean_cycles_y = 445,
        .statistics_stopped_y = 485,
        .update_sd_y = 565,
        .update_wifi_y = 615,
        .software_version_y = 725,
        .software_serial_y = 765,
        .software_credits_y = 805,
        .help_icon_x = 2,
        .help_icon_y = -3,
        .credit_button_x = 5,
        .action_btn_w = 76,
        .action_btn_h = 40,
        .section_line_x = 0,
        .section_font = &lv_font_montserrat_28,
        .item_font = &lv_font_montserrat_20,
        .button_icon_font = &FilMachineFontIcons_30,
        .credit_button_font = &lv_font_montserrat_18,
    },

    .popups = {
        .message_w = 320,
        .message_h = 240,
        .message_title_line_w = 200,
        .roller_w = 300,
        .roller_h = 220,
        .roller_title_line_w = 200,
        .roller_content_w = 265,
        .roller_content_h = 170,
        .roller_wheel_h = 100,
        .roller_wheel_y = -30,
        .filter_w = 320,
        .filter_h = 240,
        .filter_title_line_w = 200,
        .clean_w = 320,
        .clean_h = 280,
        .clean_title_line_w = 200,
        .clean_settings_w = 320,
        .clean_settings_h = 240,
        .clean_process_w = 320,
        .clean_process_h = 240,
        .drain_w = 320,
        .drain_h = 280,
        .drain_title_line_w = 200,
        .drain_confirm_w = 320,
        .drain_confirm_h = 240,
        .drain_process_w = 320,
        .drain_process_h = 240,
        .selfcheck_w = 440,
        .selfcheck_h = 290,
        .selfcheck_title_line_w = 320,
        .ota_wifi_w = 380,
        .ota_wifi_h = 260,
        .ota_progress_w = 360,
        .ota_progress_h = 200,
        .ota_status_w = 320,
        .ota_percent_w = 320,
        .ota_progress_bar_w = 300,
        .ota_progress_bar_h = 30,
        .splash_w = 380,
        .splash_h = 320,
        .splash_title_line_w = 280,
    },

    .splash_popup = {
        .title_y = -5,
        .title_line_y = 22,
        .default_switch_y = 34,
        .random_switch_y = 73,
        .switch_row_w = 342,
        .options_x = 0,
        .options_y = 112,
        .options_h = 120,
        .options_w = 350,
        .row_h = 32,
        .row_gap = 7,
        .label_x = 5,
        .label_y_offset = 4,
        .roller_x = -5,
        .roller_w = 175,
        .roller_h = 30,
        .roller_visible_rows = 1,
        .slider_w = 130,
        .slider_x = -5,
        .slider_y_offset = 7,
        .title_x = 0,
        .title_line_x = 0,
        .switch_row_x = 0,
        .switch_x = 0,
        .switch_y = 0,
        .close_btn_x = 0,
        .close_btn_w = 110,
        .close_btn_h = 38,
        .close_btn_y = 8,
        .switch_label_y = 0,
        .x_close_w = 35,
        .x_close_h = 35,
        .x_close_x = 5,
        .x_close_y = -7,
        .overlay_opa = 170,
        .title_font = &lv_font_montserrat_20,
        .label_font = &lv_font_montserrat_14,
        .button_font = &lv_font_montserrat_16,
        .value_font = &lv_font_montserrat_14,
        .close_icon_font = &FilMachineFontIcons_20,
    },

    .splash_screen = {
        .subtitle_x = 0,
        .subtitle_y = 6,
        .version_x = -8,
        .version_y = -4,
        .play_icon_x = -60,
        .play_icon_y = -60,
        .play_hit_w = 110,
        .play_hit_h = 110,
        .play_hit_x = -10,
        .play_hit_y = -10,
    },

    .filter_popup = {
        .title_x = 0,
        .title_y = -10,
        .title_line_x = 0,
        .title_line_y = 23,
        .close_x = 7,
        .close_y = -10,
        .close_w = 30,
        .close_h = 30,
        .close_icon_size = 20,
        .name_container_x = -7,
        .name_container_y = 30,
        .name_container_w = 300,
        .name_container_h = 40,
        .name_label_x = -10,
        .name_label_y = 0,
        .name_textarea_x = 65,
        .name_textarea_y = 0,
        .name_textarea_w = 215,
        .color_row_y = -5,
        .bw_row_y = -5,
        .preferred_row_y = 35,
        .filter_options_container_x = -7,
        .filter_options_container_w = 300,
        .filter_options_container_h = 40,
        .color_box_x = -20,
        .color_box_y = 0,
        .bw_box_x = 80,
        .bw_box_y = 0,
        .preferred_box_x = 0,
        .filter_box_default_w = 100,
        .color_box_w = 100,
        .bw_box_w = 100,
        .preferred_box_w = 100,
        .filter_box_h = 40,
        .filter_label_x = -10,
        .color_radio_x = 25,
        .bw_radio_x = 25,
        .preferred_radio_x = 25,
        .option_radio_size = 27,
        .preferred_switch_x = 95,
        .filter_label_offset_x = -10,
        .filter_label_offset_y = 0,
        .apply_reset_btn_y = 10,
        .apply_reset_btn_x = 10,
        .action_btn_w = 110,
        .action_btn_h = 45,
        .title_font = &lv_font_montserrat_22,
        .label_font = &lv_font_montserrat_22,
        .button_font = &lv_font_montserrat_22,
        .close_icon_font = &FilMachineFontIcons_20,
        .textarea_font = &lv_font_montserrat_22,
        .radio_font = &lv_font_montserrat_18,
    },

    .selfcheck_popup = {
        .title_x = 0,
        .title_y = -10,
        .title_line_x = 0,
        .title_line_y = 23,
        .close_x = 7,
        .close_y = -10,
        .close_icon_size = 20,
        .close_w = 30,
        .close_h = 30,
        .left_panel_x = -5,
        .left_panel_y = 30,
        .left_panel_w = 155,
        .left_panel_h = 220,
        .tasks_label_x = 5,
        .tasks_label_y = 0,
        .phase_icon_x = 5,
        .phase_name_x = 25,
        .phase_row_y = 22,
        .phase_row_gap = 27,
        .right_panel_x = 150,
        .right_panel_y = 30,
        .right_panel_w = 280,
        .right_panel_h = 250,
        .phase_title_x = 0,
        .phase_title_w = 270,
        .phase_title_y = 0,
        .phase_desc_x = 0,
        .phase_desc_w = 270,
        .phase_desc_y = 28,
        .phase_status_x = 0,
        .phase_status_w = 270,
        .phase_status_y = 80,
        .phase_timer_x = 0,
        .phase_timer_y = 130,
        .progress_bar_x = 0,
        .progress_bar_w = 260,
        .progress_bar_h = 25,
        .progress_bar_y = 155,
        .control_btn_w = 82,
        .control_btn_h = 33,
        .control_btn_y = 195,
        .stop_button_x = 0,
        .start_button_x = 90,
        .advance_button_x = 180,
        .title_font = &lv_font_montserrat_22,
        .tasks_font = &lv_font_montserrat_16,
        .phase_icon_font = &FilMachineFontIcons_15,
        .phase_name_font = &lv_font_montserrat_14,
        .phase_title_font = &lv_font_montserrat_20,
        .phase_desc_font = &lv_font_montserrat_14,
        .phase_status_font = &lv_font_montserrat_16,
        .control_btn_font = &lv_font_montserrat_18,
        .advance_button_font = &lv_font_montserrat_16,
        .close_icon_font = &FilMachineFontIcons_20,
    },

    .ota_popup = {
        .title_x = 0,
        .title_y = -10,
        .title_line_x = 0,
        .title_line_y = 23,
        .close_x = 7,
        .close_y = -10,
        .close_icon_size = 20,
        .close_w = 30,
        .close_h = 30,
        .ip_label_x = 0,
        .ip_label_w = 360,
        .ip_label_y = 40,
        .pin_label_x = 0,
        .pin_label_w = 360,
        .pin_label_y = 80,
        .status_label_x = 0,
        .status_label_w = 360,
        .status_label_y = 130,
        .progress_x = 0,
        .progress_h = 25,
        .progress_y = 170,
        .progress_radius = 4,
        .progress_status_x = 0,
        .progress_status_y = 40,
        .progress_bar_y = 85,
        .percent_x = 0,
        .percent_y = 125,
        .progress_popup_radius = 6,
        .title_font = &lv_font_montserrat_22,
        .close_icon_font = &FilMachineFontIcons_20,
        .ip_font = &lv_font_montserrat_22,
        .pin_font = &lv_font_montserrat_28,
        .status_font = &lv_font_montserrat_16,
        .progress_status_font = &lv_font_montserrat_18,
        .percent_font = &lv_font_montserrat_22,
    },

    .message_popup = {
        .title_x = 0,
        .title_y = -10,
        .title_line_x = 0,
        .title_line_y = 23,
        .text_container_x = 0,
        .text_container_y = 30,
        .text_container_w = 305,
        .text_container_h = 180,
        .text_w = 295,
        .close_btn_x = 7,
        .close_btn_y = -10,
        .close_w = 30,
        .close_h = 30,
        .secondary_btn_x = 10,
        .primary_btn_x = 10,
        .action_btn_y = 10,
        .action_btn_w = 110,
        .action_btn_h = 45,
        .title_font = &lv_font_montserrat_22,
        .text_font = &lv_font_montserrat_20,
        .button_font = &lv_font_montserrat_24,
        .close_icon_font = &FilMachineFontIcons_20,
    },

    .process_element = {
        .card_w = 365,
        .card_h = 70,
        .card_x = -10,
        .list_start_y = -10,
        .swipe_offset = 50,
        .delete_btn_w = 60,
        .delete_btn_h = 70,
        .delete_btn_x = -16,
        .delete_btn_y = -18,
        .delete_icon_x = -5,
        .delete_icon_y = 0,
        .card_content_w = 270,
        .card_content_h = 66,
        .card_content_x = 34,
        .card_content_y = -16,
        .name_w = 220,
        .name_x = -10,
        .name_y = -10,
        .temp_icon_x = -10,
        .temp_icon_y = 17,
        .temp_value_x = 7,
        .temp_value_y = 17,
        .time_icon_x = 65,
        .time_icon_y = 17,
        .time_value_x = 87,
        .time_value_y = 17,
        .time_icon_no_temp_x = -10,
        .time_value_no_temp_x = 12,
        .type_icon_x = 7,
        .type_icon_y = 0,
        .preferred_icon_x = 15,
        .preferred_icon_y = 0,
        .time_width_margin = 18,
        .name_font = &lv_font_montserrat_22,
        .detail_font = &lv_font_montserrat_18,
        .detail_icon_font = &FilMachineFontIcons_20,
        .type_icon_font = &FilMachineFontIcons_30,
        .delete_icon_font = &FilMachineFontIcons_30,
    },

    .step_element = {
        .card_w = 340,
        .card_h = 70,
        .card_x = -13,
        .list_start_y = -13,
        .swipe_offset = 50,
        .delete_btn_w = 60,
        .delete_btn_h = 70,
        .delete_btn_x = -16,
        .delete_btn_y = -18,
        .delete_icon_x = -5,
        .delete_icon_y = 0,
        .edit_btn_w = 60,
        .edit_btn_h = 70,
        .edit_btn_x = 260,
        .edit_btn_y = -18,
        .edit_icon_x = 5,
        .edit_icon_y = 0,
        .card_content_w = 235,
        .card_content_h = 66,
        .card_content_x = 34,
        .card_content_y = -16,
        .type_icon_x = -9,
        .type_icon_y = -12,
        .name_w = 175,
        .name_x = 12,
        .name_y = -12,
        .time_icon_x = -10,
        .time_icon_y = 17,
        .time_value_x = 12,
        .time_value_y = 17,
        .source_w = 120,
        .source_x = 85,
        .source_y = 17,
        .discard_icon_x = 13,
        .discard_icon_y = 17,
        .name_font = &lv_font_montserrat_22,
        .detail_font = &lv_font_montserrat_18,
        .detail_icon_font = &FilMachineFontIcons_20,
        .type_icon_font = &FilMachineFontIcons_20,
        .delete_icon_font = &FilMachineFontIcons_30,
        .edit_icon_font = &FilMachineFontIcons_30,
    },

    .buttons = {
        .process_h = 40,
        .process_w = 95,
        .start_h = 90,
        .start_w = 140,
        .msgbox_btn_h = 45,
        .msgbox_btn_w = 110,
        .popup_close_h = 30,
        .popup_close_w = 30,
        .tune_h = 35,
        .tune_w = 80,
        .logo_h = 89,
        .logo_w = 102,
    },

    .keyboard = {
        .textarea_y = 10,
        .textarea_h = 80,
        .keyboard_font = &lv_font_montserrat_26,
        .textarea_font = &lv_font_montserrat_30,
    },

    .clean_drain_container_h = 40,
    .clean_spinbox_btn_offset = 5,
    .title_line_width = 2,
    .element_border_width = 4,
    .element_shadow_width = 5,
    .element_shadow_spread = 3,
    .selfcheck_progress_radius = 4,
};

