UI_DEBUG_ENTRY(gui.page.home.screen_home, "gui.page.home.screen_home");
UI_DEBUG_ENTRY(gui.page.home.startButton, "gui.page.home.startButton");
UI_DEBUG_ENTRY(gui.page.home.splashImage, "gui.page.home.splashImage");
UI_DEBUG_ENTRY(gui.page.home.errorButtonLabel, "gui.page.home.errorButtonLabel");
UI_DEBUG_ENTRY(gui.page.home.errorLabel, "gui.page.home.errorLabel");

UI_DEBUG_ENTRY(gui.page.menu.screen_mainMenu, "gui.page.menu.screen_mainMenu");
UI_DEBUG_ENTRY(gui.page.menu.processesTab, "gui.page.menu.processesTab");
UI_DEBUG_ENTRY(gui.page.menu.settingsTab, "gui.page.menu.settingsTab");
UI_DEBUG_ENTRY(gui.page.menu.toolsTab, "gui.page.menu.toolsTab");
UI_DEBUG_ENTRY(gui.page.menu.iconLabel, "gui.page.menu.iconLabel");
UI_DEBUG_ENTRY(gui.page.menu.label, "gui.page.menu.label");

UI_DEBUG_ENTRY(gui.page.processes.processesSection, "gui.page.processes.processesSection");
UI_DEBUG_ENTRY(gui.page.processes.sectionTitleLine, "gui.page.processes.sectionTitleLine");
UI_DEBUG_ENTRY(gui.page.processes.processesLabel, "gui.page.processes.processesLabel");
UI_DEBUG_ENTRY(gui.page.processes.iconFilterLabel, "gui.page.processes.iconFilterLabel");
UI_DEBUG_ENTRY(gui.page.processes.iconNewProcessLabel, "gui.page.processes.iconNewProcessLabel");
UI_DEBUG_ENTRY(gui.page.processes.processesListContainer, "gui.page.processes.processesListContainer");
UI_DEBUG_ENTRY(gui.page.processes.processFilterButton, "gui.page.processes.processFilterButton");
UI_DEBUG_ENTRY(gui.page.processes.newProcessButton, "gui.page.processes.newProcessButton");

UI_DEBUG_ENTRY(gui.page.settings.settingsSection, "gui.page.settings.settingsSection");
UI_DEBUG_ENTRY(gui.page.settings.sectionTitleLine, "gui.page.settings.sectionTitleLine");
UI_DEBUG_ENTRY(gui.page.settings.settingsLabel, "gui.page.settings.settingsLabel");
UI_DEBUG_ENTRY(gui.page.settings.tempUnitLabel, "gui.page.settings.tempUnitLabel");
UI_DEBUG_ENTRY(gui.page.settings.waterInletLabel, "gui.page.settings.waterInletLabel");
UI_DEBUG_ENTRY(gui.page.settings.tempSensorTuneButtonLabel, "gui.page.settings.tempSensorTuneButtonLabel");
UI_DEBUG_ENTRY(gui.page.settings.tempSensorTuningLabel, "gui.page.settings.tempSensorTuningLabel");
UI_DEBUG_ENTRY(gui.page.settings.filmRotationSpeedLabel, "gui.page.settings.filmRotationSpeedLabel");
UI_DEBUG_ENTRY(gui.page.settings.filmRotationInverseIntervalLabel, "gui.page.settings.filmRotationInverseIntervalLabel");
UI_DEBUG_ENTRY(gui.page.settings.filmRotationRandomLabel, "gui.page.settings.filmRotationRandomLabel");
UI_DEBUG_ENTRY(gui.page.settings.persistentAlarmLabel, "gui.page.settings.persistentAlarmLabel");
UI_DEBUG_ENTRY(gui.page.settings.autostartLabel, "gui.page.settings.autostartLabel");
UI_DEBUG_ENTRY(gui.page.settings.drainFillTimeLabel, "gui.page.settings.drainFillTimeLabel");
UI_DEBUG_ENTRY(gui.page.settings.multiRinseTimeLabel, "gui.page.settings.multiRinseTimeLabel");
UI_DEBUG_ENTRY(gui.page.settings.drainFillTimeValueLabel, "gui.page.settings.drainFillTimeValueLabel");
UI_DEBUG_ENTRY(gui.page.settings.multiRinseTimeValueLabel, "gui.page.settings.multiRinseTimeValueLabel");
UI_DEBUG_ENTRY(gui.page.settings.filmRotationInverseIntervalValueLabel, "gui.page.settings.filmRotationInverseIntervalValueLabel");
UI_DEBUG_ENTRY(gui.page.settings.filmRotationRandomValueLabel, "gui.page.settings.filmRotationRandomValueLabel");
UI_DEBUG_ENTRY(gui.page.settings.filmRotationSpeedValueLabel, "gui.page.settings.filmRotationSpeedValueLabel");
UI_DEBUG_ENTRY(gui.page.settings.settingsContainer, "gui.page.settings.settingsContainer");
UI_DEBUG_ENTRY(gui.page.settings.tempUnitContainer, "gui.page.settings.tempUnitContainer");
UI_DEBUG_ENTRY(gui.page.settings.waterInletContainer, "gui.page.settings.waterInletContainer");
UI_DEBUG_ENTRY(gui.page.settings.tempTuningContainer, "gui.page.settings.tempTuningContainer");
UI_DEBUG_ENTRY(gui.page.settings.filmRotationSpeedContainer, "gui.page.settings.filmRotationSpeedContainer");
UI_DEBUG_ENTRY(gui.page.settings.filmRotationInverseIntervalContainer, "gui.page.settings.filmRotationInverseIntervalContainer");
UI_DEBUG_ENTRY(gui.page.settings.randomContainer, "gui.page.settings.randomContainer");
UI_DEBUG_ENTRY(gui.page.settings.persistentAlarmContainer, "gui.page.settings.persistentAlarmContainer");
UI_DEBUG_ENTRY(gui.page.settings.autostartContainer, "gui.page.settings.autostartContainer");
UI_DEBUG_ENTRY(gui.page.settings.drainFillTimeContainer, "gui.page.settings.drainFillTimeContainer");
UI_DEBUG_ENTRY(gui.page.settings.multiRinseTimeContainer, "gui.page.settings.multiRinseTimeContainer");
UI_DEBUG_ENTRY(gui.page.settings.autostartSwitch, "gui.page.settings.autostartSwitch");
UI_DEBUG_ENTRY(gui.page.settings.persistentAlarmSwitch, "gui.page.settings.persistentAlarmSwitch");
UI_DEBUG_ENTRY(gui.page.settings.waterInletSwitch, "gui.page.settings.waterInletSwitch");
UI_DEBUG_ENTRY(gui.page.settings.filmRotationSpeedSlider, "gui.page.settings.filmRotationSpeedSlider");
UI_DEBUG_ENTRY(gui.page.settings.filmRotationInversionIntervalSlider, "gui.page.settings.filmRotationInversionIntervalSlider");
UI_DEBUG_ENTRY(gui.page.settings.filmRandomSlider, "gui.page.settings.filmRandomSlider");
UI_DEBUG_ENTRY(gui.page.settings.drainFillTimeSlider, "gui.page.settings.drainFillTimeSlider");
UI_DEBUG_ENTRY(gui.page.settings.multiRinseTimeSlider, "gui.page.settings.multiRinseTimeSlider");
UI_DEBUG_ENTRY(gui.page.settings.tempSensorTuneButton, "gui.page.settings.tempSensorTuneButton");
UI_DEBUG_ENTRY(gui.page.settings.tempCalibOffsetValueLabel, "gui.page.settings.tempCalibOffsetValueLabel");
UI_DEBUG_ENTRY(gui.page.settings.tempUnitCelsiusRadioButton, "gui.page.settings.tempUnitCelsiusRadioButton");
UI_DEBUG_ENTRY(gui.page.settings.tempUnitFahrenheitRadioButton, "gui.page.settings.tempUnitFahrenheitRadioButton");
UI_DEBUG_ENTRY(gui.page.settings.tankSizeContainer, "gui.page.settings.tankSizeContainer");
UI_DEBUG_ENTRY(gui.page.settings.tankSizeLabel, "gui.page.settings.tankSizeLabel");
UI_DEBUG_ENTRY(gui.page.settings.tankSizeTextArea, "gui.page.settings.tankSizeTextArea");
UI_DEBUG_ENTRY(gui.page.settings.pumpSpeedContainer, "gui.page.settings.pumpSpeedContainer");
UI_DEBUG_ENTRY(gui.page.settings.pumpSpeedLabel, "gui.page.settings.pumpSpeedLabel");
UI_DEBUG_ENTRY(gui.page.settings.pumpSpeedSlider, "gui.page.settings.pumpSpeedSlider");
UI_DEBUG_ENTRY(gui.page.settings.pumpSpeedValueLabel, "gui.page.settings.pumpSpeedValueLabel");
UI_DEBUG_ENTRY(gui.page.settings.chemContainerMlContainer, "gui.page.settings.chemContainerMlContainer");
UI_DEBUG_ENTRY(gui.page.settings.chemContainerMlLabel, "gui.page.settings.chemContainerMlLabel");
UI_DEBUG_ENTRY(gui.page.settings.chemContainerMlTextArea, "gui.page.settings.chemContainerMlTextArea");
UI_DEBUG_ENTRY(gui.page.settings.wbContainerMlContainer, "gui.page.settings.wbContainerMlContainer");
UI_DEBUG_ENTRY(gui.page.settings.wbContainerMlLabel, "gui.page.settings.wbContainerMlLabel");
UI_DEBUG_ENTRY(gui.page.settings.wbContainerMlTextArea, "gui.page.settings.wbContainerMlTextArea");
UI_DEBUG_ENTRY(gui.page.settings.chemVolumeContainer, "gui.page.settings.chemVolumeContainer");
UI_DEBUG_ENTRY(gui.page.settings.chemVolumeLabel, "gui.page.settings.chemVolumeLabel");
UI_DEBUG_ENTRY(gui.page.settings.chemVolumeTextArea, "gui.page.settings.chemVolumeTextArea");
UI_DEBUG_ENTRY(gui.page.settings.otaSectionLabel, "gui.page.settings.otaSectionLabel");
UI_DEBUG_ENTRY(gui.page.settings.otaWifiSSIDContainer, "gui.page.settings.otaWifiSSIDContainer");
UI_DEBUG_ENTRY(gui.page.settings.otaWifiSSIDLabel, "gui.page.settings.otaWifiSSIDLabel");
UI_DEBUG_ENTRY(gui.page.settings.otaWifiSSIDTextArea, "gui.page.settings.otaWifiSSIDTextArea");
UI_DEBUG_ENTRY(gui.page.settings.otaWifiPasswordContainer, "gui.page.settings.otaWifiPasswordContainer");
UI_DEBUG_ENTRY(gui.page.settings.otaWifiPasswordLabel, "gui.page.settings.otaWifiPasswordLabel");
UI_DEBUG_ENTRY(gui.page.settings.otaWifiPasswordTextArea, "gui.page.settings.otaWifiPasswordTextArea");

UI_DEBUG_ENTRY(gui.page.tools.toolsSection, "gui.page.tools.toolsSection");
UI_DEBUG_ENTRY(gui.page.tools.sectionTitleLine, "gui.page.tools.sectionTitleLine");
UI_DEBUG_ENTRY(gui.page.tools.toolsCleaningContainer, "gui.page.tools.toolsCleaningContainer");
UI_DEBUG_ENTRY(gui.page.tools.toolsDrainingContainer, "gui.page.tools.toolsDrainingContainer");
UI_DEBUG_ENTRY(gui.page.tools.toolsSelfcheckContainer, "gui.page.tools.toolsSelfcheckContainer");
UI_DEBUG_ENTRY(gui.page.tools.toolsImportContainer, "gui.page.tools.toolsImportContainer");
UI_DEBUG_ENTRY(gui.page.tools.toolsExportContainer, "gui.page.tools.toolsExportContainer");
UI_DEBUG_ENTRY(gui.page.tools.toolsCleaningLabel, "gui.page.tools.toolsCleaningLabel");
UI_DEBUG_ENTRY(gui.page.tools.toolsDrainingLabel, "gui.page.tools.toolsDrainingLabel");
UI_DEBUG_ENTRY(gui.page.tools.toolsSelfcheckLabel, "gui.page.tools.toolsSelfcheckLabel");
UI_DEBUG_ENTRY(gui.page.tools.toolsImportLabel, "gui.page.tools.toolsImportLabel");
UI_DEBUG_ENTRY(gui.page.tools.toolsExportLabel, "gui.page.tools.toolsExportLabel");
UI_DEBUG_ENTRY(gui.page.tools.toolsCleaningButton, "gui.page.tools.toolsCleaningButton");
UI_DEBUG_ENTRY(gui.page.tools.toolsCleaningButtonLabel, "gui.page.tools.toolsCleaningButtonLabel");
UI_DEBUG_ENTRY(gui.page.tools.toolsDrainingButton, "gui.page.tools.toolsDrainingButton");
UI_DEBUG_ENTRY(gui.page.tools.toolsDrainingButtonLabel, "gui.page.tools.toolsDrainingButtonLabel");
UI_DEBUG_ENTRY(gui.page.tools.toolsSelfcheckButton, "gui.page.tools.toolsSelfcheckButton");
UI_DEBUG_ENTRY(gui.page.tools.toolsSelfcheckButtonLabel, "gui.page.tools.toolsSelfcheckButtonLabel");
UI_DEBUG_ENTRY(gui.page.tools.toolsImportButton, "gui.page.tools.toolsImportButton");
UI_DEBUG_ENTRY(gui.page.tools.toolsImportButtonLabel, "gui.page.tools.toolsImportButtonLabel");
UI_DEBUG_ENTRY(gui.page.tools.toolsExportButton, "gui.page.tools.toolsExportButton");
UI_DEBUG_ENTRY(gui.page.tools.toolsExportButtonLabel, "gui.page.tools.toolsExportButtonLabel");
UI_DEBUG_ENTRY(gui.page.tools.toolsMaintenanceLabel, "gui.page.tools.toolsMaintenanceLabel");
UI_DEBUG_ENTRY(gui.page.tools.toolsUtilitiesLabel, "gui.page.tools.toolsUtilitiesLabel");
UI_DEBUG_ENTRY(gui.page.tools.toolsStatisticsLabel, "gui.page.tools.toolsStatisticsLabel");
UI_DEBUG_ENTRY(gui.page.tools.toolsSoftwareLabel, "gui.page.tools.toolsSoftwareLabel");
UI_DEBUG_ENTRY(gui.page.tools.toolsStatCompleteProcessesContainer, "gui.page.tools.toolsStatCompleteProcessesContainer");
UI_DEBUG_ENTRY(gui.page.tools.toolsStatTotalTimeContainer, "gui.page.tools.toolsStatTotalTimeContainer");
UI_DEBUG_ENTRY(gui.page.tools.toolsStatCompleteCycleContainer, "gui.page.tools.toolsStatCompleteCycleContainer");
UI_DEBUG_ENTRY(gui.page.tools.toolsStatStoppedProcessesContainer, "gui.page.tools.toolsStatStoppedProcessesContainer");
UI_DEBUG_ENTRY(gui.page.tools.toolStatCompletedProcessesLabel, "gui.page.tools.toolStatCompletedProcessesLabel");
UI_DEBUG_ENTRY(gui.page.tools.toolStatCompletedProcessesValue, "gui.page.tools.toolStatCompletedProcessesValue");
UI_DEBUG_ENTRY(gui.page.tools.toolStatTotalTimeLabel, "gui.page.tools.toolStatTotalTimeLabel");
UI_DEBUG_ENTRY(gui.page.tools.toolStatTotalTimeValue, "gui.page.tools.toolStatTotalTimeValue");
UI_DEBUG_ENTRY(gui.page.tools.toolStatCompleteCycleLabel, "gui.page.tools.toolStatCompleteCycleLabel");
UI_DEBUG_ENTRY(gui.page.tools.toolStatCompleteCycleValue, "gui.page.tools.toolStatCompleteCycleValue");
UI_DEBUG_ENTRY(gui.page.tools.toolStatStoppedProcessesLabel, "gui.page.tools.toolStatStoppedProcessesLabel");
UI_DEBUG_ENTRY(gui.page.tools.toolStatStoppedProcessesValue, "gui.page.tools.toolStatStoppedProcessesValue");
UI_DEBUG_ENTRY(gui.page.tools.toolsSoftwareVersionContainer, "gui.page.tools.toolsSoftwareVersionContainer");
UI_DEBUG_ENTRY(gui.page.tools.toolsSoftwareSerialContainer, "gui.page.tools.toolsSoftwareSerialContainer");
UI_DEBUG_ENTRY(gui.page.tools.toolSoftWareVersionLabel, "gui.page.tools.toolSoftWareVersionLabel");
UI_DEBUG_ENTRY(gui.page.tools.toolSoftwareVersionValue, "gui.page.tools.toolSoftwareVersionValue");
UI_DEBUG_ENTRY(gui.page.tools.toolSoftwareSerialLabel, "gui.page.tools.toolSoftwareSerialLabel");
UI_DEBUG_ENTRY(gui.page.tools.toolSoftwareSerialValue, "gui.page.tools.toolSoftwareSerialValue");
UI_DEBUG_ENTRY(gui.page.tools.toolCreditButton, "gui.page.tools.toolCreditButton");
UI_DEBUG_ENTRY(gui.page.tools.toolCreditButtonLabel, "gui.page.tools.toolCreditButtonLabel");
UI_DEBUG_ENTRY(gui.page.tools.toolsUpdateContainer, "gui.page.tools.toolsUpdateContainer");
UI_DEBUG_ENTRY(gui.page.tools.toolsUpdateSDLabel, "gui.page.tools.toolsUpdateSDLabel");
UI_DEBUG_ENTRY(gui.page.tools.toolsUpdateSDButton, "gui.page.tools.toolsUpdateSDButton");
UI_DEBUG_ENTRY(gui.page.tools.toolsUpdateSDButtonLabel, "gui.page.tools.toolsUpdateSDButtonLabel");
UI_DEBUG_ENTRY(gui.page.tools.toolsUpdateWifiContainer, "gui.page.tools.toolsUpdateWifiContainer");
UI_DEBUG_ENTRY(gui.page.tools.toolsUpdateWifiLabel, "gui.page.tools.toolsUpdateWifiLabel");
UI_DEBUG_ENTRY(gui.page.tools.toolsUpdateWifiButton, "gui.page.tools.toolsUpdateWifiButton");
UI_DEBUG_ENTRY(gui.page.tools.toolsUpdateWifiButtonLabel, "gui.page.tools.toolsUpdateWifiButtonLabel");

UI_DEBUG_ENTRY(gui.element.filterPopup.mBoxFilterPopupParent, "gui.element.filterPopup.mBoxFilterPopupParent");
UI_DEBUG_ENTRY(gui.element.filterPopup.mBoxStepPopupTitleLine, "gui.element.filterPopup.mBoxStepPopupTitleLine");
UI_DEBUG_ENTRY(gui.element.filterPopup.mBoxContainer, "gui.element.filterPopup.mBoxContainer");
UI_DEBUG_ENTRY(gui.element.filterPopup.mBoxTitle, "gui.element.filterPopup.mBoxTitle");
UI_DEBUG_ENTRY(gui.element.filterPopup.mBoxNameContainer, "gui.element.filterPopup.mBoxNameContainer");
UI_DEBUG_ENTRY(gui.element.filterPopup.mBoxNameLabel, "gui.element.filterPopup.mBoxNameLabel");
UI_DEBUG_ENTRY(gui.element.filterPopup.selectColorContainerRadioButton, "gui.element.filterPopup.selectColorContainerRadioButton");
UI_DEBUG_ENTRY(gui.element.filterPopup.mBoxColorLabel, "gui.element.filterPopup.mBoxColorLabel");
UI_DEBUG_ENTRY(gui.element.filterPopup.mBoxBnWLabel, "gui.element.filterPopup.mBoxBnWLabel");
UI_DEBUG_ENTRY(gui.element.filterPopup.mBoxPreferredContainer, "gui.element.filterPopup.mBoxPreferredContainer");
UI_DEBUG_ENTRY(gui.element.filterPopup.mBoxPreferredLabel, "gui.element.filterPopup.mBoxPreferredLabel");
UI_DEBUG_ENTRY(gui.element.filterPopup.mBoxResetFilterLabel, "gui.element.filterPopup.mBoxResetFilterLabel");
UI_DEBUG_ENTRY(gui.element.filterPopup.mBoxApplyFilterLabel, "gui.element.filterPopup.mBoxApplyFilterLabel");
UI_DEBUG_ENTRY(gui.element.filterPopup.mBoxNameTextArea, "gui.element.filterPopup.mBoxNameTextArea");
UI_DEBUG_ENTRY(gui.element.filterPopup.mBoxSelectColorRadioButton, "gui.element.filterPopup.mBoxSelectColorRadioButton");
UI_DEBUG_ENTRY(gui.element.filterPopup.mBoxSelectBnWRadioButton, "gui.element.filterPopup.mBoxSelectBnWRadioButton");
UI_DEBUG_ENTRY(gui.element.filterPopup.mBoxOnlyPreferredSwitch, "gui.element.filterPopup.mBoxOnlyPreferredSwitch");
UI_DEBUG_ENTRY(gui.element.filterPopup.mBoxResetFilterButton, "gui.element.filterPopup.mBoxResetFilterButton");
UI_DEBUG_ENTRY(gui.element.filterPopup.mBoxApplyFilterButton, "gui.element.filterPopup.mBoxApplyFilterButton");
UI_DEBUG_ENTRY(gui.element.filterPopup.mBoxCloseButton, "gui.element.filterPopup.mBoxCloseButton");
UI_DEBUG_ENTRY(gui.element.filterPopup.mBoxCloseButtonLabel, "gui.element.filterPopup.mBoxCloseButtonLabel");

UI_DEBUG_ENTRY(gui.element.cleanPopup.cleanPopupParent, "gui.element.cleanPopup.cleanPopupParent");
UI_DEBUG_ENTRY(gui.element.cleanPopup.cleanPopupTitleLine, "gui.element.cleanPopup.cleanPopupTitleLine");
UI_DEBUG_ENTRY(gui.element.cleanPopup.cleanContainer, "gui.element.cleanPopup.cleanContainer");
UI_DEBUG_ENTRY(gui.element.cleanPopup.cleanTitle, "gui.element.cleanPopup.cleanTitle");
UI_DEBUG_ENTRY(gui.element.cleanPopup.cleanSubTitleLabel, "gui.element.cleanPopup.cleanSubTitleLabel");
UI_DEBUG_ENTRY(gui.element.cleanPopup.cleanSettingsContainer, "gui.element.cleanPopup.cleanSettingsContainer");
UI_DEBUG_ENTRY(gui.element.cleanPopup.cleanChemicalTanksContainer, "gui.element.cleanPopup.cleanChemicalTanksContainer");
UI_DEBUG_ENTRY(gui.element.cleanPopup.cleanSelectC1CheckBox, "gui.element.cleanPopup.cleanSelectC1CheckBox");
UI_DEBUG_ENTRY(gui.element.cleanPopup.cleanSelectC2CheckBox, "gui.element.cleanPopup.cleanSelectC2CheckBox");
UI_DEBUG_ENTRY(gui.element.cleanPopup.cleanSelectC3CheckBox, "gui.element.cleanPopup.cleanSelectC3CheckBox");
UI_DEBUG_ENTRY(gui.element.cleanPopup.cleanC1CheckBoxLabel, "gui.element.cleanPopup.cleanC1CheckBoxLabel");
UI_DEBUG_ENTRY(gui.element.cleanPopup.cleanC2CheckBoxLabel, "gui.element.cleanPopup.cleanC2CheckBoxLabel");
UI_DEBUG_ENTRY(gui.element.cleanPopup.cleanC3CheckBoxLabel, "gui.element.cleanPopup.cleanC3CheckBoxLabel");
UI_DEBUG_ENTRY(gui.element.cleanPopup.cleanRepeatTimesLabel, "gui.element.cleanPopup.cleanRepeatTimesLabel");
UI_DEBUG_ENTRY(gui.element.cleanPopup.cleanSpinBoxContainer, "gui.element.cleanPopup.cleanSpinBoxContainer");
UI_DEBUG_ENTRY(gui.element.cleanPopup.cleanSpinBox, "gui.element.cleanPopup.cleanSpinBox");
UI_DEBUG_ENTRY(gui.element.cleanPopup.cleanSpinBoxPlusButton, "gui.element.cleanPopup.cleanSpinBoxPlusButton");
UI_DEBUG_ENTRY(gui.element.cleanPopup.cleanSpinBoxMinusButton, "gui.element.cleanPopup.cleanSpinBoxMinusButton");
UI_DEBUG_ENTRY(gui.element.cleanPopup.cleanDrainWaterLabelContainer, "gui.element.cleanPopup.cleanDrainWaterLabelContainer");
UI_DEBUG_ENTRY(gui.element.cleanPopup.cleanDrainWaterLabel, "gui.element.cleanPopup.cleanDrainWaterLabel");
UI_DEBUG_ENTRY(gui.element.cleanPopup.cleanDrainWaterSwitch, "gui.element.cleanPopup.cleanDrainWaterSwitch");
UI_DEBUG_ENTRY(gui.element.cleanPopup.cleanCancelButton, "gui.element.cleanPopup.cleanCancelButton");
UI_DEBUG_ENTRY(gui.element.cleanPopup.cleanCancelButtonLabel, "gui.element.cleanPopup.cleanCancelButtonLabel");
UI_DEBUG_ENTRY(gui.element.cleanPopup.cleanRunButton, "gui.element.cleanPopup.cleanRunButton");
UI_DEBUG_ENTRY(gui.element.cleanPopup.cleanRunButtonLabel, "gui.element.cleanPopup.cleanRunButtonLabel");
UI_DEBUG_ENTRY(gui.element.cleanPopup.cleanProcessContainer, "gui.element.cleanPopup.cleanProcessContainer");
UI_DEBUG_ENTRY(gui.element.cleanPopup.cleanProcessArc, "gui.element.cleanPopup.cleanProcessArc");
UI_DEBUG_ENTRY(gui.element.cleanPopup.cleanCycleArc, "gui.element.cleanPopup.cleanCycleArc");
UI_DEBUG_ENTRY(gui.element.cleanPopup.cleanPumpArc, "gui.element.cleanPopup.cleanPumpArc");
UI_DEBUG_ENTRY(gui.element.cleanPopup.cleanRemainingTimeValue, "gui.element.cleanPopup.cleanRemainingTimeValue");
UI_DEBUG_ENTRY(gui.element.cleanPopup.cleanNowStepLabelValue, "gui.element.cleanPopup.cleanNowStepLabelValue");
UI_DEBUG_ENTRY(gui.element.cleanPopup.cleanNowCleaningLabel, "gui.element.cleanPopup.cleanNowCleaningLabel");
UI_DEBUG_ENTRY(gui.element.cleanPopup.cleanNowCleaningValue, "gui.element.cleanPopup.cleanNowCleaningValue");
UI_DEBUG_ENTRY(gui.element.cleanPopup.cleanStopButton, "gui.element.cleanPopup.cleanStopButton");
UI_DEBUG_ENTRY(gui.element.cleanPopup.cleanStopButtonLabel, "gui.element.cleanPopup.cleanStopButtonLabel");

UI_DEBUG_ENTRY(gui.element.drainPopup.drainPopupParent, "gui.element.drainPopup.drainPopupParent");
UI_DEBUG_ENTRY(gui.element.drainPopup.drainContainer, "gui.element.drainPopup.drainContainer");
UI_DEBUG_ENTRY(gui.element.drainPopup.drainTitle, "gui.element.drainPopup.drainTitle");
UI_DEBUG_ENTRY(gui.element.drainPopup.drainTitleLine, "gui.element.drainPopup.drainTitleLine");
UI_DEBUG_ENTRY(gui.element.drainPopup.drainCloseButton, "gui.element.drainPopup.drainCloseButton");
UI_DEBUG_ENTRY(gui.element.drainPopup.drainCloseButtonLabel, "gui.element.drainPopup.drainCloseButtonLabel");
UI_DEBUG_ENTRY(gui.element.drainPopup.drainConfirmContainer, "gui.element.drainPopup.drainConfirmContainer");
UI_DEBUG_ENTRY(gui.element.drainPopup.drainInfoLabel, "gui.element.drainPopup.drainInfoLabel");
UI_DEBUG_ENTRY(gui.element.drainPopup.drainStartButton, "gui.element.drainPopup.drainStartButton");
UI_DEBUG_ENTRY(gui.element.drainPopup.drainStartButtonLabel, "gui.element.drainPopup.drainStartButtonLabel");
UI_DEBUG_ENTRY(gui.element.drainPopup.drainCancelButton, "gui.element.drainPopup.drainCancelButton");
UI_DEBUG_ENTRY(gui.element.drainPopup.drainCancelButtonLabel, "gui.element.drainPopup.drainCancelButtonLabel");
UI_DEBUG_ENTRY(gui.element.drainPopup.drainProcessContainer, "gui.element.drainPopup.drainProcessContainer");
UI_DEBUG_ENTRY(gui.element.drainPopup.tankBar[0], "gui.element.drainPopup.tankBar[0]");
UI_DEBUG_ENTRY(gui.element.drainPopup.tankBar[1], "gui.element.drainPopup.tankBar[1]");
UI_DEBUG_ENTRY(gui.element.drainPopup.tankBar[2], "gui.element.drainPopup.tankBar[2]");
UI_DEBUG_ENTRY(gui.element.drainPopup.tankBar[3], "gui.element.drainPopup.tankBar[3]");
UI_DEBUG_ENTRY(gui.element.drainPopup.tankLabel[0], "gui.element.drainPopup.tankLabel[0]");
UI_DEBUG_ENTRY(gui.element.drainPopup.tankLabel[1], "gui.element.drainPopup.tankLabel[1]");
UI_DEBUG_ENTRY(gui.element.drainPopup.tankLabel[2], "gui.element.drainPopup.tankLabel[2]");
UI_DEBUG_ENTRY(gui.element.drainPopup.tankLabel[3], "gui.element.drainPopup.tankLabel[3]");
UI_DEBUG_ENTRY(gui.element.drainPopup.drainStatusLabel, "gui.element.drainPopup.drainStatusLabel");
UI_DEBUG_ENTRY(gui.element.drainPopup.drainWasteLabel, "gui.element.drainPopup.drainWasteLabel");
UI_DEBUG_ENTRY(gui.element.drainPopup.drainTimeLabel, "gui.element.drainPopup.drainTimeLabel");
UI_DEBUG_ENTRY(gui.element.drainPopup.drainStopButton, "gui.element.drainPopup.drainStopButton");
UI_DEBUG_ENTRY(gui.element.drainPopup.drainStopButtonLabel, "gui.element.drainPopup.drainStopButtonLabel");

UI_DEBUG_ENTRY(gui.element.selfcheckPopup.selfcheckPopupParent, "gui.element.selfcheckPopup.selfcheckPopupParent");
UI_DEBUG_ENTRY(gui.element.selfcheckPopup.selfcheckContainer, "gui.element.selfcheckPopup.selfcheckContainer");
UI_DEBUG_ENTRY(gui.element.selfcheckPopup.selfcheckTitle, "gui.element.selfcheckPopup.selfcheckTitle");
UI_DEBUG_ENTRY(gui.element.selfcheckPopup.selfcheckTitleLine, "gui.element.selfcheckPopup.selfcheckTitleLine");
UI_DEBUG_ENTRY(gui.element.selfcheckPopup.leftPanel, "gui.element.selfcheckPopup.leftPanel");
UI_DEBUG_ENTRY(gui.element.selfcheckPopup.tasksLabel, "gui.element.selfcheckPopup.tasksLabel");
UI_DEBUG_ENTRY(gui.element.selfcheckPopup.phaseIcon[0], "gui.element.selfcheckPopup.phaseIcon[0]");
UI_DEBUG_ENTRY(gui.element.selfcheckPopup.phaseIcon[1], "gui.element.selfcheckPopup.phaseIcon[1]");
UI_DEBUG_ENTRY(gui.element.selfcheckPopup.phaseIcon[2], "gui.element.selfcheckPopup.phaseIcon[2]");
UI_DEBUG_ENTRY(gui.element.selfcheckPopup.phaseIcon[3], "gui.element.selfcheckPopup.phaseIcon[3]");
UI_DEBUG_ENTRY(gui.element.selfcheckPopup.phaseIcon[4], "gui.element.selfcheckPopup.phaseIcon[4]");
UI_DEBUG_ENTRY(gui.element.selfcheckPopup.phaseIcon[5], "gui.element.selfcheckPopup.phaseIcon[5]");
UI_DEBUG_ENTRY(gui.element.selfcheckPopup.phaseIcon[6], "gui.element.selfcheckPopup.phaseIcon[6]");
UI_DEBUG_ENTRY(gui.element.selfcheckPopup.phaseNameLabel[0], "gui.element.selfcheckPopup.phaseNameLabel[0]");
UI_DEBUG_ENTRY(gui.element.selfcheckPopup.phaseNameLabel[1], "gui.element.selfcheckPopup.phaseNameLabel[1]");
UI_DEBUG_ENTRY(gui.element.selfcheckPopup.phaseNameLabel[2], "gui.element.selfcheckPopup.phaseNameLabel[2]");
UI_DEBUG_ENTRY(gui.element.selfcheckPopup.phaseNameLabel[3], "gui.element.selfcheckPopup.phaseNameLabel[3]");
UI_DEBUG_ENTRY(gui.element.selfcheckPopup.phaseNameLabel[4], "gui.element.selfcheckPopup.phaseNameLabel[4]");
UI_DEBUG_ENTRY(gui.element.selfcheckPopup.phaseNameLabel[5], "gui.element.selfcheckPopup.phaseNameLabel[5]");
UI_DEBUG_ENTRY(gui.element.selfcheckPopup.phaseNameLabel[6], "gui.element.selfcheckPopup.phaseNameLabel[6]");
UI_DEBUG_ENTRY(gui.element.selfcheckPopup.rightPanel, "gui.element.selfcheckPopup.rightPanel");
UI_DEBUG_ENTRY(gui.element.selfcheckPopup.phaseTitle, "gui.element.selfcheckPopup.phaseTitle");
UI_DEBUG_ENTRY(gui.element.selfcheckPopup.phaseDescription, "gui.element.selfcheckPopup.phaseDescription");
UI_DEBUG_ENTRY(gui.element.selfcheckPopup.phaseStatus, "gui.element.selfcheckPopup.phaseStatus");
UI_DEBUG_ENTRY(gui.element.selfcheckPopup.phaseTimer, "gui.element.selfcheckPopup.phaseTimer");
UI_DEBUG_ENTRY(gui.element.selfcheckPopup.progressBar, "gui.element.selfcheckPopup.progressBar");
UI_DEBUG_ENTRY(gui.element.selfcheckPopup.closeButton, "gui.element.selfcheckPopup.closeButton");
UI_DEBUG_ENTRY(gui.element.selfcheckPopup.closeButtonLabel, "gui.element.selfcheckPopup.closeButtonLabel");
UI_DEBUG_ENTRY(gui.element.selfcheckPopup.stopButton, "gui.element.selfcheckPopup.stopButton");
UI_DEBUG_ENTRY(gui.element.selfcheckPopup.stopButtonLabel, "gui.element.selfcheckPopup.stopButtonLabel");
UI_DEBUG_ENTRY(gui.element.selfcheckPopup.startButton, "gui.element.selfcheckPopup.startButton");
UI_DEBUG_ENTRY(gui.element.selfcheckPopup.startButtonLabel, "gui.element.selfcheckPopup.startButtonLabel");
UI_DEBUG_ENTRY(gui.element.selfcheckPopup.advanceButton, "gui.element.selfcheckPopup.advanceButton");
UI_DEBUG_ENTRY(gui.element.selfcheckPopup.advanceButtonLabel, "gui.element.selfcheckPopup.advanceButtonLabel");

UI_DEBUG_ENTRY(gui.element.otaWifiPopup.popupParent, "gui.element.otaWifiPopup.popupParent");
UI_DEBUG_ENTRY(gui.element.otaWifiPopup.popupContainer, "gui.element.otaWifiPopup.popupContainer");
UI_DEBUG_ENTRY(gui.element.otaWifiPopup.titleLabel, "gui.element.otaWifiPopup.titleLabel");
UI_DEBUG_ENTRY(gui.element.otaWifiPopup.titleLine, "gui.element.otaWifiPopup.titleLine");
UI_DEBUG_ENTRY(gui.element.otaWifiPopup.closeButton, "gui.element.otaWifiPopup.closeButton");
UI_DEBUG_ENTRY(gui.element.otaWifiPopup.closeButtonLabel, "gui.element.otaWifiPopup.closeButtonLabel");
UI_DEBUG_ENTRY(gui.element.otaWifiPopup.ipLabel, "gui.element.otaWifiPopup.ipLabel");
UI_DEBUG_ENTRY(gui.element.otaWifiPopup.pinLabel, "gui.element.otaWifiPopup.pinLabel");
UI_DEBUG_ENTRY(gui.element.otaWifiPopup.statusLabel, "gui.element.otaWifiPopup.statusLabel");
UI_DEBUG_ENTRY(gui.element.otaWifiPopup.progressBar, "gui.element.otaWifiPopup.progressBar");

UI_DEBUG_ENTRY(gui.element.otaProgressPopup.popupParent, "gui.element.otaProgressPopup.popupParent");
UI_DEBUG_ENTRY(gui.element.otaProgressPopup.popupContainer, "gui.element.otaProgressPopup.popupContainer");
UI_DEBUG_ENTRY(gui.element.otaProgressPopup.titleLabel, "gui.element.otaProgressPopup.titleLabel");
UI_DEBUG_ENTRY(gui.element.otaProgressPopup.titleLine, "gui.element.otaProgressPopup.titleLine");
UI_DEBUG_ENTRY(gui.element.otaProgressPopup.closeButton, "gui.element.otaProgressPopup.closeButton");
UI_DEBUG_ENTRY(gui.element.otaProgressPopup.closeButtonLabel, "gui.element.otaProgressPopup.closeButtonLabel");
UI_DEBUG_ENTRY(gui.element.otaProgressPopup.statusLabel, "gui.element.otaProgressPopup.statusLabel");
UI_DEBUG_ENTRY(gui.element.otaProgressPopup.progressBar, "gui.element.otaProgressPopup.progressBar");
UI_DEBUG_ENTRY(gui.element.otaProgressPopup.percentLabel, "gui.element.otaProgressPopup.percentLabel");

UI_DEBUG_ENTRY(gui.element.messagePopup.mBoxPopupParent, "gui.element.messagePopup.mBoxPopupParent");
UI_DEBUG_ENTRY(gui.element.messagePopup.mBoxPopupTitleLine, "gui.element.messagePopup.mBoxPopupTitleLine");
UI_DEBUG_ENTRY(gui.element.messagePopup.mBoxPopupContainer, "gui.element.messagePopup.mBoxPopupContainer");
UI_DEBUG_ENTRY(gui.element.messagePopup.mBoxPopupTextContainer, "gui.element.messagePopup.mBoxPopupTextContainer");
UI_DEBUG_ENTRY(gui.element.messagePopup.mBoxPopupTitle, "gui.element.messagePopup.mBoxPopupTitle");
UI_DEBUG_ENTRY(gui.element.messagePopup.mBoxPopupText, "gui.element.messagePopup.mBoxPopupText");
UI_DEBUG_ENTRY(gui.element.messagePopup.mBoxPopupButtonLabel, "gui.element.messagePopup.mBoxPopupButtonLabel");
UI_DEBUG_ENTRY(gui.element.messagePopup.mBoxPopupButton1Label, "gui.element.messagePopup.mBoxPopupButton1Label");
UI_DEBUG_ENTRY(gui.element.messagePopup.mBoxPopupButton2Label, "gui.element.messagePopup.mBoxPopupButton2Label");
UI_DEBUG_ENTRY(gui.element.messagePopup.mBoxPopupButtonClose, "gui.element.messagePopup.mBoxPopupButtonClose");
UI_DEBUG_ENTRY(gui.element.messagePopup.mBoxPopupButton1, "gui.element.messagePopup.mBoxPopupButton1");
UI_DEBUG_ENTRY(gui.element.messagePopup.mBoxPopupButton2, "gui.element.messagePopup.mBoxPopupButton2");

UI_DEBUG_ENTRY(gui.element.rollerPopup.mBoxRollerParent, "gui.element.rollerPopup.mBoxRollerParent");
UI_DEBUG_ENTRY(gui.element.rollerPopup.mBoxRollerTitleLine, "gui.element.rollerPopup.mBoxRollerTitleLine");
UI_DEBUG_ENTRY(gui.element.rollerPopup.roller, "gui.element.rollerPopup.roller");
UI_DEBUG_ENTRY(gui.element.rollerPopup.mBoxRollerContainer, "gui.element.rollerPopup.mBoxRollerContainer");
UI_DEBUG_ENTRY(gui.element.rollerPopup.mBoxRollerTitle, "gui.element.rollerPopup.mBoxRollerTitle");
UI_DEBUG_ENTRY(gui.element.rollerPopup.mBoxRollerButton, "gui.element.rollerPopup.mBoxRollerButton");
UI_DEBUG_ENTRY(gui.element.rollerPopup.mBoxRollerButtonLabel, "gui.element.rollerPopup.mBoxRollerButtonLabel");
UI_DEBUG_ENTRY(gui.element.rollerPopup.mBoxRollerRollerContainer, "gui.element.rollerPopup.mBoxRollerRollerContainer");

UI_DEBUG_ENTRY(gui.element.keyboardPopup.keyBoardParent, "gui.element.keyboardPopup.keyBoardParent");
UI_DEBUG_ENTRY(gui.element.keyboardPopup.keyboard, "gui.element.keyboardPopup.keyboard");
UI_DEBUG_ENTRY(gui.element.keyboardPopup.keyboardTextArea, "gui.element.keyboardPopup.keyboardTextArea");